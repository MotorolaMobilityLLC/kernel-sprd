## drivers/staging/sprd/sipa/Kconfig
```kconfig
menu "SIPA modules"

config SPRD_SIPA
	bool "Sprd IPA"
	default n
	help
	  SIPA is a module for spreadtrum ip packet accelator driver.

config SPRD_SIPA_WCN
	bool "Enable sipa for WCN"
	default n
	depends on SPRD_SIPA
	help
	  This option enables sipa interface for WCN.

config SIPA_TEST
	bool "Enable sipa test module"
	default n
	depends on SPRD_SIPA
	help
	  This option enables sipa test module.

endmenu
```

## drivers/staging/sprd/sipa_delegate/Kconfig
```kconfig
menu "SIPA delegate modules"
config SPRD_SIPA_DELEGATE
	bool "Enable delegate for modem side sipa"
	default n
	depends on SPRD_SIPA
	help
	  This option enables delegate for modem side sipa.

endmenu
```

## drivers/staging/sprd/sipa_sys/Kconfig
```kconfig
menu "Sipa System Modules"

config SPRD_IPA_SYS
	tristate "Spreadtrum Ipa Sys Power Management"
	default n
	help
	  Sipa sys is a module that manages ipa low power.
	  Its main function is to provide a power interface to the outside.

endmenu
```

## drivers/unisoc_platform/Kconfig
```kconfig
#
# UNISOC MODEM drivers
#
source "drivers/unisoc_platform/iommu/Kconfig"
source "drivers/unisoc_platform/modem_loader/Kconfig"
source "drivers/unisoc_platform/sipc_virt_bus/Kconfig"
source "drivers/unisoc_platform/mailbox/Kconfig"
source "drivers/unisoc_platform/sprdwcn/Kconfig"
source "drivers/unisoc_platform/sprd_gnss/Kconfig"
source "drivers/unisoc_platform/sprd_map/Kconfig"
source "drivers/unisoc_platform/wlan/Kconfig"
source "drivers/unisoc_platform/sprd_apdu/Kconfig"
source "drivers/unisoc_platform/cp_dump/Kconfig"
source "drivers/unisoc_platform/debug_log/Kconfig"
```

## drivers/unisoc_platform/audio/Kconfig
```kconfig
# SPDX-License-Identifier: GPL-2.0-only
#
# UNISOC audio driver
#

menu "UNISOC audio devices"

source "drivers/unisoc_platform/audio/sprd/Kconfig"
source "drivers/unisoc_platform/audio/sprd_audio/Kconfig"

endmenu
```

## drivers/unisoc_platform/audio/sprd/Kconfig
```kconfig
config SND_SOC_UNISOC
	tristate "ASoC Audio for the UNISOC platform"
	depends on ARCH_SPRD
	help
	  Say Y or M here if you want to build Spreadtrum ASOC card.

config SND_SOC_UNISOC_I2S
	tristate #"ASoC Spreadtrum AP I2S sound card(bypass VBC) support"
	help
	  Say Y if you want to build in to kernel, Say M for ko module.
	  this option will build Spreadtrum AP I2S driver for card bypasses
	  VBC module, e.g. external codec or like BT/Digital FM etc.

config SND_SOC_UNISOC_VBC_V4_SC2730
	tristate "ASoC Spreadtrum sound card with vbc v4 and codec sc2730"
	select UNISOC_AUDIO_AGDSP_ACCESS
	select UNISOC_AUDIO_MEMORY_MANAGER
	select UNISOC_AUDIO_SIPC
	select UNISOC_AUDIO_MCDT
	select UNISOC_AUDIO_DSP_DUMP
	select UNISOC_AUDIO_CPBOOT
	select UNISOC_HW_DEVICE_DVFS_AGCP
	select SND_SOC_UNISOC_VBC_V4
	select SND_SOC_UNISOC_CODEC_SC2730
	select SND_SOC_UNISOC_CODEC_DUMMY
	select SND_SOC_UNISOC_AUDIO_DMAENGINE
	select SND_SOC_COMPRESS
	help
	  Say Y or M here if you want to add support for ASoC audio on
	  Spreadtrum boards using the VBC v4 and the sc2730 codec.
	  ASOC machine with cpu dai vbc v4 and codec dai sc2730.
	  This vbc is in audio cp, so we should select communication config
	  and data transmit config.

config SND_SOC_UNISOC_VBC_V4_SC2730_MCDT_R2P0
	tristate "ASoC Spreadtrum sound card with vbc v4 and codec sc2730 mcdt r2p0"
	select UNISOC_AUDIO_AGDSP_ACCESS
	select UNISOC_AUDIO_MEMORY_MANAGER
	select UNISOC_AUDIO_SIPC
	select UNISOC_AUDIO_MCDT_R2P0
	select UNISOC_AUDIO_DSP_DUMP
	select UNISOC_AUDIO_CPBOOT
	select UNISOC_HW_DEVICE_DVFS_AGCP
	select SND_SOC_UNISOC_VBC_V4
	select SND_SOC_UNISOC_CODEC_SC2730
	select SND_SOC_UNISOC_CODEC_DUMMY
	select SND_SOC_UNISOC_AUDIO_DMAENGINE
	select SND_SOC_COMPRESS
	help
	  Say Y or M here if you want to add support for ASoC audio on
	  Spreadtrum boards using the VBC v4 and the sc2730 codec and mcdt r2p0.
	  ASOC machine with cpu dai vbc v4 and codec dai sc2730.
	  This vbc is in audio cp, so we should select communication config
	  and data transmit config.

config SND_SOC_UNISOC_VBC_V4_UMP9620_MCDT_R2P0
	tristate "ASoC Spreadtrum sound card with vbc v4 and codec ump9620 and mcdt r2p0"
	select UNISOC_AUDIO_AGDSP_ACCESS
	select UNISOC_AUDIO_MEMORY_MANAGER
	select UNISOC_AUDIO_SIPC
	select UNISOC_AUDIO_MCDT_R2P0
	select UNISOC_AUDIO_DSP_DUMP
	select UNISOC_AUDIO_CPBOOT
	select UNISOC_HW_DEVICE_DVFS_AGCP
	select SND_SOC_UNISOC_VBC_V4
	select SND_SOC_UNISOC_CODEC_UMP9620
	select SND_SOC_UNISOC_CODEC_DUMMY
	select SND_SOC_UNISOC_AUDIO_DMAENGINE
	select SND_SOC_COMPRESS
	help
	  Say Y or M here if you want to add support for ASoC audio on
	  Spreadtrum boards using the VBC v4 and the ump9620 codec.
	  ASOC machine with cpu dai vbc v4 and codec dai ump9620.
	  This vbc is in audio cp, so we should select communication config
	  and data transmit config.

config SND_SOC_UNISOC_I2S_DUMMY
	tristate "ASoC Spreadtrum sound card with AP I2S and a dummy codec"
	select SND_SOC_UNISOC_I2S
	help
	  Say Y or M here if you want to add support for ASoC audio on Spreadtrum
	  boards using the AP I2S and a dummy codec.

config SND_SOC_UNISOC_R1P0V3_SC2721
	tristate "ASoC Spreadtrum sound card with vbc r1p0 v3 and codec sc2721"
	select UNISOC_AUDIO_MEMORY_MANAGER
	select SND_SOC_UNISOC_AUDIO_TWO_STAGE_DMAENGINE
	select SND_SOC_UNISOC_VBC_R1P0V3
	select SND_SOC_UNISOC_CODEC_SC2721
	select SND_SOC_UNISOC_CODEC_DUMMY
	select SND_SOC_UNISOC_VAUDIO
	help
	  Sound card with vbc r1p0 v3 and codec sc2721.
	  Say Y or M here if you want to add support for ASoC audio on Spreadtrum
	  boards using the R1P0 V3 VBC and the sc2721 codec.

config SND_SOC_UNISOC_SHARKL3
	tristate "ASoC Spreadtrum sound card for sharkl3 chip"
	help
	  Say Y or M here if you want to add support for ASoC audio on Spreadtrum
	  boards using sharkl3 chip
config SND_SOC_UNISOC_SHARKLE
	tristate "ASoC Spreadtrum sound card for sharklE chip"
	help
	  Say Y or M here if you want to add support for ASoC audio on Spreadtrum
	  boards using sharklE chip

config SND_SOC_UNISOC_PIKE2
	tristate "ASoC Spreadtrum sound card for pike2 chip"
	help
	  Say Y or M here if you want to add support for ASoC audio on Spreadtrum
	  boards using pike2 chip

source "drivers/unisoc_platform/audio/sprd/dai/vbc/Kconfig"
source "drivers/unisoc_platform/audio/sprd/dai/i2s/Kconfig"
source "drivers/unisoc_platform/audio/sprd/dai/vaudio/Kconfig"
source "drivers/unisoc_platform/audio/sprd/platform/Kconfig"
source "drivers/unisoc_platform/audio/sprd/codec/sprd/Kconfig"
source "drivers/unisoc_platform/audio/sprd/codec/dummy-codec/Kconfig"
```

## drivers/unisoc_platform/audio/sprd/codec/dummy-codec/Kconfig
```kconfig
config SND_SOC_UNISOC_CODEC_DUMMY
	tristate "Sprd codec dummy"
	help
	  If the codec is the dummy, set this to Y or M, else N.
```

## drivers/unisoc_platform/audio/sprd/codec/sprd/dp/Kconfig
```kconfig
config SND_SOC_UNISOC_DP_CODEC
	tristate "unisoc dp codec"
	default n
	help
		Say Y or M here if you want to use dp feature.
```

## drivers/unisoc_platform/audio/sprd/codec/sprd/pdm_r2p0/Kconfig
```kconfig
config SND_SOC_UNISOC_PDM_R2P0
	tristate "Sprd pdm r2p0"
	help
	  If using pdm r2p0, set this to Y or M, else N.
```

## drivers/unisoc_platform/audio/sprd/dai/Kconfig
```kconfig
menu "UNISOC CPU DAI"

config SND_SOC_UNISOC_DAI
	tristate "UNISOC dai"
	default n
	help
		Say Y or M here if you want to use unisoc dai.

endmenu
```

## drivers/unisoc_platform/audio/sprd/dai/vbc/Kconfig
```kconfig
menu "SPRD VBC Dai Version"
source "drivers/unisoc_platform/audio/sprd/dai/vbc/v4/Kconfig"
source "drivers/unisoc_platform/audio/sprd/dai/vbc/r1p0v3/Kconfig"
endmenu
```

## drivers/unisoc_platform/audio/sprd/dai/vbc/v4/Kconfig
```kconfig
config SND_SOC_UNISOC_VBC_V4
	tristate "VBC V4"
	help
	  If the chip is the series of sharkl5,
	  set Y or M, else N.
```

## drivers/unisoc_platform/audio/sprd/platform/Kconfig
```kconfig
menu "SPRD Platform"

config SND_SOC_UNISOC_AUDIO_TWO_STAGE_DMAENGINE
	tristate "Use 2 stage dma engine"
	help
	  Say Y if you want to use 2stage dma engine, 2 stage dma is
           designed for low power.

config SND_SOC_UNISOC_AUDIO_DMAENGINE
	tristate "platform DMA engine"
	help
	  If the platform DMA engine is used, set Y or M, else N.
endmenu
```

## drivers/unisoc_platform/audio/sprd_audio/Kconfig
```kconfig
menu "UNISOC Audio Assistant Modules"
config UNISOC_AUDIO_AGDSP_ACCESS
	tristate "Sprd audio agdsp access"
	help
	  This module is used to enable the access
	  of agdsp registers.
	  If audio use audio cp, this config should be selected.
	  If r3p0 vbc is used, this must be set to Y.

config UNISOC_AUDIO_MEMORY_MANAGER
	tristate "Sprd audio memory manager"
	help
	  This module is used to manager memories that needed by offlad play(mp3 play),
	  music data buffer used by dma, audio sipc and share memory.
	  If r3p0 vbc is used, this must be set to Y.
	  Say Y if you support audio memory manager.

config UNISOC_AUDIO_PIPE
	tristate "Sprd audio pipe"
	help
	  This module is used to audio pipe.
	  Say Y if you support audio pipe.

config UNISOC_AUDIO_DSP_DUMP
	tristate "Sprd audio dsp dump"
	help
		This module is used to dump dsp log,
		memory and pcm data.
		The main purpers is support debug information.
		Say Y if you support dsp dump.

config UNISOC_AUDIO_SIPC
	tristate "Sprd audio sipc"
	depends on UNISOC_AUDIO_MEMORY_MANAGER
	help
		This module is used to communication with
		other processor(e.g. agdsp).
		It depends on mailbox and audio memeroy manager.
		Say Y if you support sipc.

config UNISOC_AUDIO_SAUDIO
	tristate "Sprd saudio driver in call mode based on sipc"
	depends on SPRD_SIPC
	default N
	help
	  Say Y if you want to built in to kernel, Say M for ko module.
	  SAudio is a bridge to connect AP and CP system.

config UNISOC_AUDIO_MCDT
	tristate "Spreadtrum MCDT support"
	default n
	help
	  MCDT(Multi-Channel Data Transfer) is a Hardware module
	  that can be used to transfer data between AP and DSP,
	  normally we use it transfer audio data.
	  Say Y if your platform supports hardware MCDT.

config UNISOC_AUDIO_MCDT_R2P0
	tristate "Spreadtrum MCDT_R2P0 support"
	default n
	help
	  MCDT_r2p0(Multi-Channel Data Transfer) is a Hardware module
	  that can be used to transfer data between AP and DSP,
	  normally we use it transfer audio data.
	  Say Y if your platform supports hardware MCDT_r2p0.

config UNISOC_HW_DEVICE_DVFS_AGCP
	tristate "Spreadtrum AGCP dvfs driver"
	depends on UNISOC_AUDIO_MEMORY_MANAGER
	help
	   This driver supports dvfs interfaces for PUBCP DVFS and WTLCP DVFS at user specidied.

config UNISOC_AUDIO_CPBOOT
	tristate "Spreadtrum AGCP boot driver"
	depends on UNISOC_AUDIO_MEMORY_MANAGER
	help
	  Audio cp boot driver is used for reboot audio cp in kernel.
	  It support interface for userspace to stop audio cp, download dsp bin and
	  start audio cp.

config UNISOC_AUDIO_VOICE_TRIGGER
	tristate "Sprd audio voice trigger"
	default n
	help
		This module is used to create a file node for voice trigger,
		it will be used by audio HAL.
		Say Y if you support voice trigger.

config SND_SOC_XS200X
	tristate "XS200X Voice Trigger"
	default n
	help
		XS200X Voice Trigger driver

config SND_SOC_AK4377_HIFI
	tristate "AK4377_HIFI"
	default n
	help
		AK4377_HIFI
endmenu
```

## drivers/unisoc_platform/cpufreq/Kconfig
```kconfig
# SPDX-License-Identifier: GPL-2.0-only
#
# unisoc multi freq control for cpufreq
#

config UNISOC_MULTI_FREQ_CONTROL
	tristate "enable unisoc multi freq control"
	depends on CPU_FREQ
	help
	This option enables cpufreq high level freq control for user.
```

## drivers/unisoc_platform/debug/Kconfig
```kconfig
config SPRD_DEBUG
	bool "Spreadtrum debug module"
	depends on ARCH_SPRD || COMPILE_TEST
	help
	  Say y here to enable Debug support.

config SPRD_LOOK_AT
	tristate "Sprdtrum lookat tool support"
	depends on SPRD_DEBUG || COMPILE_TEST
	default n
	help
	  this macro is for lookat driver, lookat is a debug tool that is used to
	  view the content of arm/arm64 of the address space through usb port,
	  such as the register of each module, DDR address space, etc.
	  When in doubt, say n

source "drivers/unisoc_platform/debug/busmonitor/Kconfig"
source "drivers/unisoc_platform/debug/djtag/Kconfig"
source "drivers/unisoc_platform/debug/dmc_mpu/Kconfig"
source "drivers/unisoc_platform/debug/userspace_debug/Kconfig"
```

## drivers/unisoc_platform/debug/userspace_debug/Kconfig
```kconfig
config SHOW_UREGS_WITH_PHYSICAL
	tristate "SPRD userspace debug: show uregs with phys"
	depends on ARM64
	help
	  This option enables process show user regs with their physcial
          address before coredump
```

## drivers/unisoc_platform/domain/Kconfig
```kconfig
# SPDX-License-Identifier: GPL-2.0
config SPRD_CAMSYS_PW_DOMAIN
	tristate "SPRD camsys power domain"
	depends on ARCH_SPRD || COMPILE_TEST
	select PM_GENERIC_DOMAINS if PM
	help
	  If you select this feature, it will enable the camera sys power domain.
```

## drivers/unisoc_platform/hang_debug/Kconfig
```kconfig
config SPRD_HANG_DEBUG
	bool "Enable SPRD hang debug feature"
	default n
	help
	  This option enables SPRD hang debug feature which dump and
	  print debug info when kernel panics.

config SPRD_APHANG
	tristate "Enable SPRD hang debug wdf wdh feature"
	depends on SPRD_HANG_DEBUG
	help
	  This option combines two ko, wdh and wdf,
	  in order to reduce the number of ko and
	  ensures that the original function
	  is not lost.

config SPRD_HANG_RESET
	bool "trigger cm4 handling ap watchdog reset"
	depends on SPRD_APHANG
	default y

config SPRD_HANG_TRIGGER
	bool "supply a driver for trigger AP cpu hang"
	depends on SPRD_HANG_DEBUG
	help
	  This option triggers SPRD cpu hang.
```

## drivers/unisoc_platform/irq_monitor/Kconfig
```kconfig
config	IRQ_MONITOR
	tristate "Warn if interrupts occur too frequently"
	help
	  If selected, a warning log will be thrown out if any interrupt occurs
	  too frequently.
```

## drivers/unisoc_platform/mailbox/Kconfig
```kconfig
#
# SPRD MAILBOX drivers
#
config UNISOC_MAILBOX
	tristate "Unisoc Mailbox"
	depends on ARCH_SPRD || COMPILE_TEST
	select MAILBOX
	help
	  Mailbox driver implementation for the Unisoc platform only. It is used
	  to send message between application processors and MCU. Say Y here if
	  you want to build the Unisoc mailbox controller driver.
```

## drivers/unisoc_platform/mm/Kconfig
```kconfig
# SPDX-License-Identifier: GPL-2.0-only
#
# unisoc memory managerment vendor hook
#
menu "Unisoc Memory Management Vendor Hook"

source "drivers/unisoc_platform/mm/emem/Kconfig"

endmenu
```
