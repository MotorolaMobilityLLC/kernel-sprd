## modules/kernel5.4/input/misc/ltr_558als/Kconfig
```kconfig
#
# Makefile for LTR558 als sensor driver.
#
config INPUT_LTR558_I2C
	tristate "LTR558 als sensor support"
	depends on I2C
	help
	  Say Y here to enable support for the LTR's
	  ALS sensor LTR558.

	  To compile this driver as a module, choose M here: the
	  module will be called LTR558.
```

## modules/kernel5.4/input/misc/mc34xx/Kconfig
```kconfig
# mCube start
config INPUT_MC34XX_I2C
 	tristate "mCube mc34xx 3-Axis accelerometer device with I2C bus"
 	depends on I2C
 	default y
	help
	  Say Y here if you have a mc3xxx device on the board and use I2C
	  communication, else say N.

	  To compile this driver as a module, choose M here.
# mCube end
```
