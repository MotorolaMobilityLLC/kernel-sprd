## drivers/unisoc_platform/mm/reclaim/Kconfig
```kconfig
# SPDX-License-Identifier: GPL-2.0-only

config UNISOC_MM_RECLAIM
	tristate "mm vendor hook for unisoc"
	default n
	help
	  This option enables unisoc precise reclaim policy,
	  which include asynchronously reclaiming inactive file LRU,
	  shrinking reclaimable slabs cache and changing swappiness
	  in dirctly reclaim path.

config UNISOC_MM_SHRINKLRU
	bool "mm kshrink lru for unisoc"
	depends on UNISOC_MM_RECLAIM
	default n
	help
	  This option enables unisoc asynchronous shrinklru reclaim function
```

## drivers/unisoc_platform/modem/modem_loader/Kconfig
```kconfig
config UNISOC_MODEM_LOADER
	tristate "UNISOC Modem Loader"
	select UNISOC_MODEM_POWER_MANAGER
	default n
	help
	  UNISOC modem loader driver. It be user for modem poweron,
	  modem image load, modem memory dump, modem boot and modem reset.
```

## drivers/unisoc_platform/modem_loader/Kconfig
```kconfig
config UNISOC_MODEM_LOADER
	tristate "UNISOC Modem Loader"
	select SPRD_MODEM_POWER_MANAGER
	default n
	help
	  UNISOC modem loader driver. It be user for modem poweron,
	  modem image load, modem memory dump, modem boot and modem reset.
```

## drivers/unisoc_platform/net/Kconfig
```kconfig
# SPDX-License-Identifier: GPL-2.0-only
#
# Unisoc Network device configuration
#

menu "Unisoc Net Devices"

source "drivers/unisoc_platform/net/seth/Kconfig"

endmenu
```

## drivers/unisoc_platform/net/sipa_v3/Kconfig
```kconfig
menu "SIPA_V3 modules"

config UNISOC_SIPA_V3
	tristate "UNISOC SIPA_V3"
	default n
	help
	  SIPA is a module designed by Spreadtrum to
	  accelerate IP packets, which is mainly suitable
	  for 5g scenarios.

	  This option be opend indicate that the SIPA
	  module will use the SIPA version 3.

config UNISOC_SIPA_ETH
	tristate "UNISOC Cellular Data Network Card"
	default n
	depends on UNISOC_SIPA_V3
	help
	  Sprd Cellular data network card, all Cellular data will be sent and
	  received through this network card.

	  This module is a cellular data network card virtualized on the basis
	  of sipa, it is only used to send Cellular network data.

config UNISOC_SIPA_USB
	tristate "UNISOC Sipa Usb Networ Card"
	default n
	depends on UNISOC_SIPA_V3
	help
	  Sprd usb network card, all usb network data will be sent and received
	  through this network card.

	  This module is a usb network card virtualized on the basis of sipa,
	  it is only used to send Cellular network data.

endmenu
```

## drivers/unisoc_platform/performance/Kconfig
```kconfig
config SPRD_PTM
	tristate "Spreadtrum Performance Trace Monitor Support"
	default m
	depends on SPRD_DEBUG
	help
	  Say M here to support ptm support.
```

## drivers/unisoc_platform/power/power_stat/Kconfig
```kconfig
menuconfig SPRD_POWER_STAT
	tristate "Spreadtrum debug power stat output"
	depends on ARCH_SPRD
        default n
	help
	  Select this to enable debug power stat driver for sprd soc.
```

## drivers/unisoc_platform/sched/Kconfig
```kconfig
# SPDX-License-Identifier: GPL-2.0-only
#
# unisoc scheduler based on WALT
#
menu "Unisoc Scheduler Features"

config UNISOC_SCHED
	tristate "Support Unisoc Scheduler Features"
	depends on SMP
	help
	This is the base of unisoc specifec scheduler, including WALT, EAS, RT,
	cpufreq governor and so on...

config SCHED_WALT
	tristate "Support Window Assisted Load Tracking"
	depends on SMP
	depends on UNISOC_SCHED
	help
	This feature will allow the scheduler to get utilzation for tasks
	and runqueues based on window assisted load tracking. The util can be
	used to guide eas/load_balance/rt task placement as well as
	task frequency requirements for cpufreq governors.

choice
	prompt "select how to boost the cpu/task util"
	default UNISOC_GROUP_BOOST

config UNISOC_GROUP_BOOST
	bool "Using group boost just like schedtune"
	depends on SCHED_WALT
	depends on UCLAMP_TASK
	help
	This feature is porting from schedtune's boost params. It can boost the
	task and cpu when setting the val to be bigger than 0. Also It can deboost
	the task and cpu when setting the val to be smaller than 0.

config UCLAMP_MIN_TO_BOOST
	bool "Transform uclamp_min to schedtune.boost"
	depends on SCHED_WALT
	depends on UCLAMP_TASK
	help
	This feature would transform the uclamp_min to stune.boost.
	Meantime, add sysctl to let users could disable the feature and using
	the original uclamp.

endchoice

config UNISOC_ROTATION_TASK
	bool "Unisoc rotation task"
	depends on SMP
	depends on SCHED_WALT
	default n
	help
	This option enables task rotation feature. In ARM big.little cpu
	topology, benchmark app may start NR_CPUS big tasks to run,
	rotation task can improve system performance between big core
	and little core.

config UNISOC_SCHEDUTIL_GOV
	tristate "Support Unisoc Schedutil Governor"
	depends on CPU_FREQ && SMP
	depends on UNISOC_SCHED
	help
	this cpufreq governor is based on the original kernel schedutil governor,
	and add unisoc specific features like freq_margin and slak_timer.

config UNISOC_HUNG_TASK_ENH
	bool "Unisoc hung task enh"
	depends on UNISOC_SCHED && DETECT_HUNG_TASK
	help
	  This feature uses whitelist/blacklist to enhance D state task detect.
	  In addition, add the detection of iowait state task.
	  If Y, check tasks according to whitelist/blacklist rule. Using whitelist
	  mode will check tasks in the list, blacklist mode will check tasks out
	  of the list.
	  If N, check all tasks.

endmenu
```

## drivers/unisoc_platform/sprd_apdu/Kconfig
```kconfig
config SPRD_APDU_R3P0
	tristate "Spreadtrum APDU R3P0 driver"
	default n
	help
	  Spreadtrum application protocol data unit driver R3P0 Support.
	  If unused, say N.
```

## drivers/unisoc_platform/sprd_disp/Kconfig
```kconfig
# SPDX-License-Identifier: GPL-2.0-only
config UNISOC_DISP
	tristate "Unisoc Display Platform"
	depends on ARCH_SPRD || COMPILE_TEST
	depends on DRM && OF
	select DRM_KMS_HELPER
	select VIDEOMODE_HELPERS
	select DRM_GEM_CMA_HELPER
	select DRM_KMS_CMA_HELPER
	select DRM_MIPI_DSI
	help
	  Choose this option if you have a Unisoc chipset.
	  If M is selected the module will be called sprd_drm.
```

## drivers/unisoc_platform/sysdump/Kconfig
```kconfig
config SPRD_SYSDUMP
	tristate "Enable UNISOC sysdump handler"
	depends on ARCH_SPRD && !KEXEC_CORE
	help
	  This option enables Spreatrum sysdump which prepare debug info
	  for u-boot to write into mmc storage after kernel panics.

config SPRD_MINI_SYSDUMP
	depends on SPRD_SYSDUMP
	bool "Enable UNISOC mini sysdump handler"
	help
	  This option enables Spreatrum mini sysdump which supplies simple
	  debug info for projects can not support external sd card after
	  system occurs kernel panics.

config SPRD_NATIVE_HANG_MONITOR
	tristate "Enable UNISOC android native hang detect handler"
	help
		This option enables Spreatrum android native hang detect which prepare debug info
		for the case to debug.

config UNISOC_LASTKMSG
	depends on SPRD_SYSDUMP || SPRD_MINI_SYSDUMP
	tristate "Enable UNISOC LASTKMSG handler"
	help
	  This option enables Unisoc LSTKMSG which supplies kernel
	  debug info.
	  1.save task sched info in minidump when panic or cpu hang.
	  2.save runqueue info in minidump when panic or cpu hang.
	  3.save current stack info in minidump when panic or cpu hang.
	  4.save per cpu register and current stack in minidump when
	  panic or cpu hang.
	  5.save per cpu irq stack in minidump when panic or wdh
	  only in 64b system.
config UNISOC_DUMP_IO
	depends on SPRD_SYSDUMP || SPRD_MINI_SYSDUMP
	tristate "Enable UNISOC dump io handler"
	help
		This option enables dump io which provide all io requests info at that time
```

## drivers/unisoc_platform/thermal/Kconfig
```kconfig
# SPDX-License-Identifier: GPL-2.0-only
#
# Generic thermal drivers configuration
#
menu "Unisoc Thermal Management"

config UNISOC_CPU_COOLING_DEVICE
        tristate "sprd cpu cooling device"
        depends on ARCH_SPRD
        depends on THERMAL_OF
        help
          This implements sprd cpu cooling mechanism through isolate cpu that
          cpu is forced into idle state from running state to mitigate temperature
          rising.

          If you want this support, you should say M here.

config UNISOC_GPU_COOLING_DEVICE
	tristate "sprd gpu cooling device"
	depends on ARCH_SPRD || THERMAL_OF
	depends on DEVFREQ_THERMAL
	help
	  Say M here to create gpu cooling device node and build power model for IPA.
	  so that the sprd cooling devices can be bound to thermal zone trip points.
	  this implements the generic gpu cooling mechanism through frequency reduction.

config UNISOC_NPU_COOLING_DEVICE
	tristate "sprd npu cooling device"
	depends on ARCH_SPRD || THERMAL_OF
	depends on DEVFREQ_THERMAL
	help
	  Say M here to create npu cooling device node and build power model for IPA.
	  so that the sprd cooling devices can be bound to thermal zone trip points.
	  this implements the generic npu cooling mechanism through frequency reduction.

config UNISOC_SOC_THERMAL
	tristate "sprd soc thermal"
	depends on ARCH_SPRD || THERMAL_OF
	help
	  Say M here to support virtual thermal for soc chip.

config UNISOC_THERMAL_CTL
	tristate "sprd thermal control"
	depends on ARCH_SPRD || THERMAL_OF
	depends on THERMAL_GOV_POWER_ALLOCATOR
	depends on CPU_FREQ_THERMAL
	help
	  Say M here to support platform thermal control.

endmenu
```

## drivers/unisoc_platform/usbpinmux/Kconfig
```kconfig
config SPRD_USBPINMUX
	tristate "Spreadtrum USBPINMUX Support"
        default n
	help
	  Say M here to support USBPINMUX.

config SPRD_USBPINMUX_QOGIRL6
	tristate "Spreadtrum QOGIRL6 USBPINMUX Support"
	depends on SPRD_USBPINMUX
        default n
	help
	  Say M here to support QOGIRL6 USBPINMUX.

config SPRD_USBPINMUX_QOGIRN6PRO
	tristate "Spreadtrum QOGIRN6PRO USBPINMUX Support"
	depends on SPRD_USBPINMUX
		default n
	help
	  Say M here to support QOGIRN6PRO USBPINMUX.
```

## drivers/unisoc_platform/wlan/Kconfig
```kconfig
# SPDX-License-Identifier: GPL-2.0-only
config WLAN_VENDOR_SPREADTRUM
	bool "Spreadtrum devices"
	default y
	---help---
	  If you have a wireless card belonging to this class, say Y.

	  Note that the answer to this question doesn't directly affect the
	  kernel: saying N will just cause the configurator to skip all
	  the questions about  cards. If you say Y, you will be asked for
	  your specific card in the following questions.

if WLAN_VENDOR_SPREADTRUM

source "drivers/unisoc_platform/wlan/common/Kconfig"
source "drivers/unisoc_platform/wlan/sc2332/Kconfig"
source "drivers/unisoc_platform/wlan/sc2355/Kconfig"
source "drivers/unisoc_platform/wlan/marlin3_sipc/Kconfig"

endif # WLAN_VENDOR_SPREADTRUM
```

## drivers/unisoc_platform/wlan/common/Kconfig
```kconfig
# SPDX-License-Identifier: GPL-2.0-only
config SPRD_WLAN
	tristate "Spreadtrum WLAN routine"
	select CFG80211
	help
	  This is common routines for Spreadtrum WCN chipsets.

if SPRD_WLAN

config SPRD_WLAN_VENDOR_SPECIFIC
	bool "Enable vendor specific support"
	default y
	help
	  This enables vendor specific support, including
	  NAN, RTT and so on.

config SPRD_WLAN_DEBUGFS
	bool "Enable debugfs support"
	depends on SPRD_WLAN
	help
	  This enables creation of debugfs files which
	  allows getting insight into the driver's state at runtime.
	  These checks and statistics might be expensive and hurt
	  the runtime performance.

endif
```

## drivers/unisoc_platform/wlan/marlin3_sipc/Kconfig
```kconfig
# SPDX-License-Identifier: GPL-2.0-only
config SC2355_SIPC_WLAN
	tristate "sc2355 WLAN support (SIPC)"
	select CFG80211
	help
	  This option enables the SIPC interface support for
	  Spreadtrum sc2355 embedded fullmac driver.

	  Say Y if you want to use the driver for a SIPC wireless module.
```

## drivers/unisoc_platform/wlan/sc2332/Kconfig
```kconfig
# SPDX-License-Identifier: GPL-2.0-only
config SC2332_WLAN
	bool
	help
	  This module adds support for Spreadtrum sc2332 IEEE802.11n
	  chipset. The drivers is a fullmac driver, which make use of
	  the cfg80211 stack.

	  It has to work with at least one of the hardware interface support.

config SC2332_SDIO_WLAN
	tristate "sc2332 WLAN support (SDIO)"
	depends on SPRD_WLAN
	depends on SDIOM
	select SC2332_WLAN
	help
	  This option enables the SDIO interface support for
	  Spreadtrum sc2332 embedded fullmac driver.

	  Say Y if you want to use the driver for a SDIO wireless module.

config SC2332_SIPC_WLAN
	tristate "sc2332 WLAN support (SIPC)"
	depends on SPRD_WLAN
	select SC2332_WLAN
	help
	  This option enables the SIPC interface support for
	  Spreadtrum sc2332 embedded fullmac driver.

	  Say Y if you want to use the driver for a SIPC wireless module.
```

## drivers/unisoc_platform/wlan/sc2355/Kconfig
```kconfig
# SPDX-License-Identifier: GPL-2.0-only
config SC2355_WLAN
	bool
	help
	  This module adds support for Spreadtrum sc2355 IEEE802.11ac
	  chipset. The drivers is a fullmac driver, which make use of
	  the cfg80211 stack.

	  It has to work with at least one of the hardware interface support.

config SC2355_SDIO_WLAN
	tristate "sc2355 WLAN support (SDIO)"
	depends on SPRD_WLAN
	select SC2355_WLAN
	help
	  This option enables the SDIO interface support for
	  Spreadtrum sc2355 embedded fullmac driver.

	  Say Y if you want to use the driver for a SDIO wireless module.

config SC2355_PCIE_WLAN
	tristate "sc2355 WLAN support (PCIE)"
	depends on SPRD_WLAN
	select SC2355_WLAN
	help
	  This option enables the PCIE interface support for
	  Spreadtrum sc2355 embedded fullmac driver.

	  Say Y if you want to use the driver for a PCIE wireless module.

config SC2355_WLAN_NAN
	bool "Enable NAN support"
	depends on SPRD_WLAN_VENDOR_SPECIFIC
	depends on SC2355_WLAN
	help
	  This enables Neighbor Awareness Networking support
	  for Spreadtrum wireless drivers.

config SC2355_WLAN_RTT
	bool "Enable RTT support"
	depends on SPRD_WLAN_VENDOR_SPECIFIC
	depends on SC2355_WLAN
	help
	  This enables Round Trip Time support
	  for Spreadtrum wireless drivers.
```

## modules/kernel5.4/input/misc/afx133/Kconfig
```kconfig
config INPUT_AFX133
	tristate "AFX133"
	depends on I2C=y
	help
	  If you say yes here you get support for AFX magnetometer sensor.
```

## modules/kernel5.4/input/misc/akm099xx/Kconfig
```kconfig
#
# Makefile for AKM09911 sensor driver.
#
config INPUT_AKM09911
     tristate "AKM magnetic device with I2C bus"
     depends on I2C
     default n
     help
       Say Y here if you have a AKM magnetic device on the board and use I2C
       communication, else say N.

       To compile this driver as a module, choose M here.
       module will be called AKM099XX.
```

## modules/kernel5.4/input/misc/kionix/Kconfig
```kconfig
#
# Makefile for KIONIX sensor driver.
#
config INPUT_SENSORS_KIONIX_ACC
	tristate "KIONIX acceleration sensor support"
	depends on I2C
	help
	  Say Y here to enable support for the KIONIX's
	  acceleration sensor KXTJ3-1057.

	  To compile this driver as a module, choose M here: the
	  module will be called kionix_accel.
```

## modules/kernel5.4/input/misc/lis2dh/Kconfig
```kconfig
config INPUT_LIS2DH
	tristate "STMicroelectronics LIS2DH/LIS2DH12 sensor"
	depends on (I2C || SPI) && SYSFS
	select INPUT_LIS2DH_I2C if (I2C)
	select INPUT_LIS2DH_SPI if (SPI)
	help
	  This driver support the STMicroelectronics LIS2DH/LIS2DH12 sensor.
	  Say Y here if you have a LIS2DH/LIS2DH12 device on the board, else say N.

	  To compile this driver as a module, choose M here. The module
	  will be called lis2dh.

config INPUT_LIS2DH_I2C
	tristate
	depends on INPUT_LIS2DH
	depends on I2C
	help
	  Say Y here if you have a LIS2DH/LIS2DH12 device on the board and use I2C
	  communication, else say N.

	  To compile this driver as a module, choose M here.

config INPUT_LIS2DH_SPI
	tristate
	depends on INPUT_LIS2DH
	depends on SPI
	help
	  Say Y here if you have a LIS2DH/LIS2DH12 device on the board and use SPI
	  communication, else say N.

	  To compile this driver as a module, choose M here.
```
