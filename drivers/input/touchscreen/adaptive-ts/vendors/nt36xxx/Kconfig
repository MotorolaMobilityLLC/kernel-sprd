## drivers/input/touchscreen/chipone/Kconfig
```kconfig
config TOUCHSCREEN_CHIPONE_SOO
    tristate "generic touchscreen chipone driver"
    help
    add support for touchscreen driver.

config TOUCHSCREEN_CHIPONE_MODEL
    string "chipone model, kernel defconfig"
    help
    chipone model, kernel defconfig
```

## drivers/input/touchscreen/focaltech_spi/Kconfig
```kconfig
#
# Focaltech Touchscreen driver configuration
#

config TOUCHSCREEN_FTS
	tristate "Focaltech Touchscreen test"
	depends on SPI_MASTER
	help
	  Say Y here if you have Focaltech touch panel.

	  If unsure, say N.

	  To compile this driver as a module, choose M here: the
	  module will be called focal_spi_ts.

config TOUCHSCREEN_FTS_DIRECTORY
    string "Focaltech ts directory name"
    default "focaltech_spi"
    depends on TOUCHSCREEN_FTS
```

## drivers/input/touchscreen/focaltech_touch/Kconfig
```kconfig
#
# Focaltech Touchscreen driver configuration
#

config TOUCHSCREEN_FOCALTECH_TS
        tristate "focaltech touchscreen for QualComm package"
        depends on SPI
        default n
        help
          Say y here if you have focaltech touch panel.

          If unsure, say N.

          To compile this driver as a module, choose M here: the
          module will be called FT8006s.

#config TOUCHSCREEN_FTS
#    bool "Focaltech Touchscreen"
#    default n
#    help
#      Say Y here if you have Focaltech touch panel.
#      If unsure, say N.
      
config TOUCHSCREEN_FTS_DIRECTORY
    string "Focaltech ts directory name"
    default "focaltech_touch"
    depends on TOUCHSCREEN_FTS
    
```

## drivers/input/touchscreen/ili9883a/Kconfig
```kconfig
config TP_ILI9883A_S00
    tristate "generic touchscreen driver"
    help
    add support for touchscreen driver.
 
```

## drivers/input/touchscreen/ilitek/Kconfig
```kconfig
config TOUCHSCREEN_ILITEK_S00
    tristate "generic touchscreen ilitek driver"
    help
    add support for touchscreen driver.
 
```

## drivers/input/touchscreen/novatek/Kconfig
```kconfig
config TOUCHSCREEN_NOVATEK_S00
    tristate "generic touchscreen novatek driver"
    help
    add support for touchscreen driver.

config TOUCHSCREEN_NOVATEK_MODEL
    string "novatek model, kernel defconfig"
    help
    novatek model, kernel defconfig
```

## drivers/media/platform/sprd-vsp/Kconfig
```kconfig
# to add sprd vsp configs in the future
config SPRD_VSP
	tristate "SPRD vsp driver"
	depends on ARCH_SPRD
```

## drivers/misc/abov/Kconfig
```kconfig
config ABOV_SAR
	bool "Abov sar sensor"

	default n
	help
	  Say Y here if you want to enable the driver of abov sar.
```

## drivers/misc/dev_features/Kconfig
```kconfig
menu "TCONFIG"

# project name	  
config T_PROJECT_P352
    bool "Project K131"
    default n
    help
	  control project k131

config T_PROJECT_NAME
    string
	default "P352" if T_PROJECT_P352
    default ""

# product info.
config T_PRODUCT_INFO
    bool "T_PRODUCT_INFO"
    default n

endmenu
```

## drivers/misc/sprd_audio/Kconfig
```kconfig
menu "Spreadtrum Audio Assistant Modules"
config SPRD_AUDIO_AGDSP_ACCESS
	tristate "Sprd audio agdsp access"
	depends on SND_SOC_SPRD
	help
	  This module is used to enable the access
	  of agdsp registers.
	  If audio use audio cp, this config should be selected.
	  If r3p0 vbc is used, this must be set to Y.

config SPRD_AUDIO_MEMORY_MANAGER
	tristate "Sprd audio memory manager"
	depends on SND_SOC_SPRD
	help
	  This module is used to manager memories that needed by offlad play(mp3 play),
	  music data buffer used by dma, audio sipc and share memory.
	  If r3p0 vbc is used, this must be set to Y.
	  Say Y if you support audio memory manager.

config SPRD_AUDIO_DSP_DUMP
	tristate "Sprd audio dsp dump"
	depends on SPRD_AUDIO_MEMORY_MANAGER
	help
		This module is used to dump dsp log,
		memory and pcm data.
		The main purpers is support debug information.
		Say Y if you support dsp dump.

config SPRD_AUDIO_SIPC
	tristate "Sprd audio sipc"
	depends on SPRD_MAILBOX && SPRD_AUDIO_MEMORY_MANAGER
	help
		This module is used to communication with
		other processor(e.g. agdsp).
		It depends on mailbox and audio memeroy manager.
		Say Y if you support sipc.

config SPRD_AUDIO_MCDT
	bool "Spreadtrum MCDT support"
	default n
	help
	  MCDT(Multi-Channel Data Transfer) is a Hardware module
	  that can be used to transfer data between AP and DSP,
	  normally we use it transfer audio data.
	  Say Y if your platform supports hardware MCDT.

endmenu
```

## drivers/misc/sprd_camera/Kconfig
```kconfig
config SPRD_CAMERA
	tristate "Spreadtrum Camera Driver"
	depends on ARCH_SPRD && ION_SPRD
	help
	    This is a camera driver for Spreadtrum SOCs.

source "drivers/misc/sprd_camera/cpp/Kconfig"
source "drivers/misc/sprd_camera/sensor/Kconfig"
```

## drivers/misc/sprd_camera/common/Kconfig
```kconfig
config SPRD_CAM_PW_DOMAIN_R1P0
	bool "Spreadtrum Camera Power Domain R1P0"
	help
	    This is a power domain driver for cam sys.

config SPRD_CAM_PW_DOMAIN_R2P0
	bool "Spreadtrum Camera Power Domain R2P0"
	help
	    This is a power domain driver for cam & dispc sys.

config SPRD_CAM_PW_DOMAIN_R3P0
	bool "Spreadtrum Camera Power Domain R3P0"
	depends on SPRD_CAMERA
	help
	    This is a power domain driver for cam & dispc sys.

config SPRD_CAM_PW_DOMAIN_R3P0V2
	bool "Spreadtrum Camera Power Domain R3P0V2"
	depends on SPRD_CAMERA
	help
	    This is a power domain driver for Spreadtrum SOCs
	    and iSharkl2.This driver open and close some clocks for iSharkl2 Cam Sys.
	    If you want to use this config,
	    please read spec and driver code, they can help you to use r3p0v2 driver

config SPRD_CAM_PW_DOMAIN_R4P0
	bool "Spreadtrum Camera Power Domain R4P0 for Pike2"
	depends on SPRD_CAMERA
	help
            This is a power domain driver for Spreadtrum SOCs
            and pike2. This driver open and close some clocks for pike2 Cam Sys.
            If you want to use this config,
            please read spec and driver code, they can help you to use r4p0 driver

config SPRD_CAM_PW_DOMAIN_R5P0
	bool "Spreadtrum Camera Power Domain R5P0"
	depends on SPRD_CAMERA
	help
	    This is a power domain driver for cam & dispc sys.
```

## drivers/misc/sprd_camera/cpp/Kconfig
```kconfig
config SPRD_CAMERA_CPP_LITE_R6P0
	bool "UNISOC Camera CPP LITE R6P0 Driver"
	depends on SPRD_CAMERA
	help
		Support for CPP on UNISOC Socs,
		it is used for image rotation,scaling and dma when using camera.
```

## drivers/misc/sprd_camera/flash/Kconfig
```kconfig
config FLASH_SC2721
	bool "Spreadtrum SC2721 flash Driver"
	depends on PMIC_SC2721
	help
	    new flash driver

config FLASH_RGB_SC2721
	bool "Spreadtrum Camera flash rgb Driver"
	depends on PMIC_SC2721
	help
	    new rgb flash driver

config FLASH_SC2703
	bool "Spreadtrum SC2703 flash Driver"
	depends on MFD_SC2703
	help
	    new flash driver
```

## drivers/misc/sprd_camera/sensor/Kconfig
```kconfig
config SPRD_CAMERA_CSI_11A
    bool "Spreadtrum Camera Intel DPHY DWC_HOST1.11A"
    depends on SPRD_CAMERA
    help
        This is a CSI conecting intel DPHY driver for Spreadtrum SOCs.

config SPRD_CAMERA_CSI_R1P0
    bool "Spreadtrum Camera Synopsys DPHY R1P0"
    depends on SPRD_CAMERA
    help
        This is a CSI conecting synopsys DPHY driver for Spreadtrum SOCs.

config SPRD_CAMERA_CSI_RECEIVER_R1P0
    bool "Spreadtrum Camera Sprd CSI2 RECEIVER R1P0"
    depends on SPRD_CAMERA
    help
        This is a CSI conecting synopsys DPHY driver for Spreadtrum SOCs.

config SPRD_CAMERA_CSI_RECEIVER_R2P0
    bool "Spreadtrum Camera Sprd CSI2 RECEIVER R2P0"
    depends on SPRD_CAMERA
    help
        This is a CSI conecting synopsys DPHY driver for Spreadtrum SOCs.

config SPRD_CAMERA_CSI_RECEIVER_R2P1
    bool "Spreadtrum Camera Sprd CSI2 RECEIVER R2P1"
    depends on SPRD_CAMERA
    help
        This is a CSI conecting synopsys DPHY driver for Spreadtrum SOCs.

config SPRD_CAMERA_CSI_R2P0
    bool "Spreadtrum Camera CSI2 R2P0"
    depends on SPRD_CAMERA
    help
        This is a CSI conecting synopsys DPHY driver for Spreadtrum SOCs.

config SPRD_CAMERA_CSI_R2P0V2
    bool "Spreadtrum Camera CSI2 R2P0 Version 2.0"
    depends on SPRD_CAMERA
    help
        This is a CSI conecting synopsys DPHY driver for Spreadtrum SOCs.

config SPRD_CAMERA_CSI_DWC_11A
    bool "Spreadtrum Camera Intel DPHY DWC_HOST1.11A"
    depends on SPRD_CAMERA
    help
        This is a CSI conecting intel DPHY driver for Spreadtrum SOCs.
```

## drivers/misc/sprd_vsp/Kconfig
```kconfig
# to add sprd vsp configs in the future
config SPRD_VSP
	tristate "SPRD vsp driver"
	depends on ION_SPRD
```

## drivers/misc/sprd_wcn_bsp/Kconfig
```kconfig
#
# Misc wcn bsp devices
#

source "drivers/misc/sprd_wcn_bsp/wcn_bsp_sdio/Kconfig"
source "drivers/misc/sprd_wcn_bsp/wcn_bsp_pcie/Kconfig"
```

## drivers/misc/sprdwcn/Kconfig
```kconfig
#
# Spreadtrum WCN device (NEW )configuration
#
menu "Spreadtrum WCN Device Drivers"
config SC23XX
	tristate "SC23XX Chip Support"
	default n
	help
	  This is support wcn chip for spreadtrum.
	  if you want to use 23xx series wcn chip of spreadtrum.
	  please say "y".

config SC2342_INTEG
	tristate "SC2342 Integrated chip Support"
	depends on SC23XX
	default n
	help
	  This is support wcn chip for spreadtrum.
	  If you want to use sc2342 integrated chip of spreadtrum.
	  Please say "y".

config SC2355
	tristate "SC2355 chip Support"
	depends on SC23XX
	default n
	help
	  This is support wcn chip for spreadtrum.
	  If you want to use sc2355 chip of spreadtrum.
	  Please say "y".

config SC2366
	tristate "SC2366 chip Support"
	depends on SC23XX
	default n
	help
	  This is support wcn chip for spreadtrum.
	  If you want to use sc2366 chip of spreadtrum.
	  Please say "y".

# sprd's SDIO device driver based on SC2355...,etc
source "drivers/misc/sprdwcn/sdio/Kconfig"

# sprd's sleep device driver based on SC2355...,etc
source "drivers/misc/sprdwcn/sleep/Kconfig"

# sprd's PCIe device driver based on SC2355...,etc
#source "drivers/misc/sprdwcn/pcie/Kconfig"

# sprd's wcn platform driver based on SC2355/SC2342...,etc
source "drivers/misc/sprdwcn/platform/Kconfig"

endmenu
```

## drivers/moto_ko/moto_swap/Kconfig
```kconfig
# SPDX-License-Identifier: GPL-2.0
config HYBRIDSWAP_ZRAM
	tristate "Compressed RAM block device support"
	depends on BLOCK && SYSFS && ZSMALLOC && CRYPTO && !ZRAM
	select CRYPTO_LZO
	help
	  Creates virtual block devices called /dev/zramX (X = 0, 1, ...).
	  Pages written to these disks are compressed and stored in memory
	  itself. These disks allow very fast I/O and compression provides
	  good amounts of memory savings.

config HYBRIDSWAP_ZRAM_WRITEBACK
       bool "Write back incompressible or idle page to backing device"
       depends on HYBRIDSWAP_ZRAM
       help
	 With incompressible page, there is no memory saving to keep it
	 in memory. Instead, write it out to backing device.
	 For this feature, admin should set up backing device via
	 /sys/block/zramX/backing_dev.

config HYBRIDSWAP_ZRAM_MEMORY_TRACKING
	bool "Track zRam block status"
	depends on HYBRIDSWAP_ZRAM && DEBUG_FS
	help
	  With this feature, admin can track the state of allocated blocks
	  of zRAM. Admin could see the information via
	  /sys/kernel/debug/zram/zramX/block_state.

config HYBRIDSWAP
	bool "Enable Hybridswap"
	depends on MEMCG && HYBRIDSWAP_ZRAM && !HYBRIDSWAP_ZRAM_WRITEBACK
	default y
	help
	  Hybridswap is a intelligent memory management solution.

config HYBRIDSWAP_SWAPD
	bool "Enable hybridswap swapd thread to reclaim anon pages in background"
	default y
	depends on HYBRIDSWAP
	help
	  swapd is a kernel thread that reclaim anonymous pages in the
	  background. When the use of swap pages reaches the watermark
	  and the refault of anonymous pages is high, the content of
	  zram will exchanged to eswap by a certain percentage.

# Selected when system need hybridswap container
config HYBRIDSWAP_CORE
	bool "Hybridswap container device support"
	depends on HYBRIDSWAP_ZRAM && HYBRIDSWAP
	default y
	help
	  Say Y here if you want to use the hybridswap
	  as the backend device in ZRAM.
	  If unsure, say N here.
	  This module can't be compiled as a module,
	  the module is as one part of the ZRAM driver.

config HYBRIDSWAP_ASYNC_COMPRESS
	bool "hypbridswap support asynchronous compress anon pages"
	depends on HYBRIDSWAP_ZRAM && HYBRIDSWAP
	default n
	help
	  Say Y here if you want to create asynchronous thread
	  for compress anon pages.
	  If unsure, say N here.
	  This feature will reduce the kswapd cpu load.

config ZRAM_5_15
	bool "zram support kernel 5.15"
	default y
	help
	  Say Y here if you want support 5.15.
	  If unsure, say N here.
	  This feature will close.
```

## drivers/net/sprd/Kconfig
```kconfig
# SPDX-License-Identifier: GPL-2.0-only
#
# Network device configuration
#

menu "Unisoc Net Devices"

source "drivers/net/sprd/seth/Kconfig"
source "drivers/net/sprd/sipa_sys/Kconfig"
source "drivers/net/sprd/sipa_v3/Kconfig"
source "drivers/net/sprd/sipa_delegate/Kconfig"

endmenu
```

## drivers/net/sprd/seth/Kconfig
```kconfig
config SPRD_SIPC_SETH
	tristate "SPRD SETH Ethernet driver"
	default n
	depends on SPRD_SIPC
	depends on SPRD_SIPC_ZERO_COPY_SIPX
	help
	  SETH driver implementation for the Spreadtrum platform.
	  This driver supports the Spreadtrum Ethernet based on
	  share memory.

	  Say M here if you want to build a module.
```

## drivers/net/sprd/sipa_delegate/Kconfig
```kconfig
menu "SIPA delegate modules"
config SPRD_IPA_DELEGATE
	tristate "Enable delegate for modem side sipa"
	default n
	depends on SPRD_IPA_V3 || SPRD_SIPC
	help
	  This option enables delegate for modem side sipa.

	  This function is used to synchronize resource status with CP,
	  ensure the synchronization of the power-on and power-off status
	  between AP and CP.
endmenu
```
