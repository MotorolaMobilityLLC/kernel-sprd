## drivers/input/fingerprint/chipone/Kconfig
```kconfig
if INPUT_FINGERPRINT
config FP_CHIPONE
	tristate "ICNT7152 fingureprint driver"
	depends on SPI
	default n
	---help---
	  chiponeic ICNT7152L fingureprint driver.
	  This is a driver based on the SPI kernel layers.

	  To compile this driver as a module, choose m here. The module will
	  be called fpsensor.
	  Say N if unsure.
endif
```

## drivers/input/fingerprint/fps_focaltech_S00/Kconfig
```kconfig
if INPUT_FINGERPRINT
config FPS_FOCALTECH_S00
	tristate "focaltech fingureprint driver"
	depends on SPI
	default n
	---help---
	  focaltech fingureprint driver.
	  This is a driver based on the SPI kernel layers.

	  To compile this driver as a module, choose m here. The module will
	  be called fpsensor.
	  Say N if unsure.
endif
```

## drivers/input/sx9328/Kconfig
```kconfig
config INPUT_SX9328
	tristate "SX9328 sar sensor support"
	depends on I2C
	help
	  Say Y here if you have SX9328
	  sar sensor hooked to an I2C bus.

	  To compile this driver as a module, choose M here: the
	  module will be called sx9328.
```
