## drivers/soc/sprd/usbpinmux/Kconfig
```kconfig
config SPRD_USBPINMUX
	tristate "Spreadtrum USBPINMUX Support"
        default n
	help
	  Say Y here to support USBPINMUX.

config SPRD_USBPINMUX_QOGIRL6
	tristate "Spreadtrum QOGIRL6 USBPINMUX Support"
        default n
	help
	  Say Y here to support QOGIRL6 USBPINMUX.
```

## drivers/staging/sprd/Kconfig
```kconfig
source "drivers/staging/sprd/mailbox/Kconfig"

source "drivers/staging/sprd/sipa/Kconfig"

source "drivers/staging/sprd/pam_ipa/Kconfig"

source "drivers/staging/sprd/sipa_sys/Kconfig"

config SPRD_DATA_TRANSPORTER
	tristate "SPRD Data Transporter"
	default n
	depends on SPRD_SIPC
	help
	  The data transporter for SC9650 miniAP.
```

## drivers/staging/sprd/mailbox/Kconfig
```kconfig
menu "SPRD Mailbox  modules"

config SPRD_MAILBOX
	bool "Spreadtrum Mailbox IPI Arch"
	default n
	help
	  Spreadtrum Mailbox is a framework to control
	  hardware communication between on-chip processors
	  through queued messages and interrupt driven
	  signals.

endmenu
```
