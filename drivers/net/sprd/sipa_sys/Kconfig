## drivers/net/sprd/sipa_sys/Kconfig
```kconfig
menu "Sipa sys modules"
config SPRD_IPA_SYS
	tristate "Sprd Ipa Sys Power Management"
	default n
	select PM_GENERIC_DOMAINS if PM
	help
	  Sipa sys is a module that manages ipa low power, realized by creating
	  a power domain.

	  When you select this feature, it will enable the pm generic
	  power domain for ipa_sys module.
endmenu
```

## drivers/net/sprd/sipa_v3/Kconfig
```kconfig
menu "SIPA_V3 modules"

config SPRD_IPA_V3
	tristate "Sprd IPA"
	default n
	help
	  SIPA is a module designed by Spreadtrum to
	  accelerate IP packets, which is mainly suitable
	  for 5g scenarios.

	  This option be opend indicate that the SIPA
	  module will use the SIPA version 3.

config SPRD_IPA_ETH
	tristate "Sprd Cellular Data Network Card"
	default n
	depends on SPRD_IPA_V3
	help
	  Sprd Cellular data network card, all Cellular data will be sent and
	  received through this network card.

	  This module is a cellular data network card virtualized on the basis
	  of sipa, it is only used to send Cellular network data.

config SPRD_IPA_USB
	tristate "Sprd Sipa Usb Networ Card"
	default n
	depends on SPRD_IPA_V3
	help
	  Sprd usb network card, all usb network data will be sent and received
	  through this network card.

	  This module is a usb network card virtualized on the basis of sipa,
	  it is only used to send Cellular network data.

endmenu
```

## drivers/nfc/pn557/Kconfig
```kconfig
config NFC_PN557
	tristate "NXP PN557 nfc driver"
	depends on I2C
	help
	  NXP PN557 core driver.
	  This is a driver based on the HCI NFC kernel layers and
	  will thus not work with NXP libnfc library.
```

## drivers/ontim/Kconfig
```kconfig
menu "ONTIM hardware info"

config ONTIM_HWINFO
	tristate "Product Hardward Info"
	help
	  Say Y or M here if you want to build hwinfo module

config ONTIM_HWINFO_VENDOR
	tristate "Product Hardward Info in vendor"
	help
	  Say Y or M here if you want to build hwinfo_vendor module

config UPDATE_GPIOS_NO_LIMIT
	bool "allow to update all gpios"
	default n
	help
	  Say Y if you can update all gpios

endmenu
```

## drivers/pinctrl/sprd/Kconfig
```kconfig
# SPDX-License-Identifier: GPL-2.0-only
#
# Spreadtrum pin control drivers
#

config PINCTRL_SPRD
	tristate
	select PINMUX
	select PINCONF
	select GENERIC_PINCONF
	select GENERIC_PINMUX_FUNCTIONS
	help
	  Say Y here to enable Spreadtrum pinctrl driver

config PINCTRL_SPRD_SC9860
	tristate "Spreadtrum SC9860 pinctrl driver"
	depends on OF
	depends on ARCH_SPRD || COMPILE_TEST
	select PINCTRL_SPRD
	help
	  Say Y here to enable Spreadtrum SC9860 pinctrl driver

config PINCTRL_SPRD_SHARKL5PRO
	tristate "Spreadtrum sharkl5pro pinctrl driver"
	depends on OF
	depends on ARCH_SPRD || COMPILE_TEST
	select PINCTRL_SPRD
	help
	  Say Y here to enable Spreadtrum sharkl5pro pinctrl driver

config PINCTRL_SPRD_SHARKL6
	tristate "Spreadtrum sharkl6 pinctrl driver"
	depends on OF
	depends on ARCH_SPRD || COMPILE_TEST
	select PINCTRL_SPRD
	help
	  Say Y here to enable Spreadtrum sharkl6 pinctrl driver

config PINCTRL_SPRD_QOGIRL6PRO
	tristate "Spreadtrum qogirl6pro pinctrl driver"
	depends on OF
	depends on ARCH_SPRD || COMPILE_TEST
	select PINCTRL_SPRD
	help
	  Say Y here to enable Spreadtrum qogirl6pro pinctrl driver
```

## drivers/soc/sprd/Kconfig
```kconfig
# SPDX-License-Identifier: GPL-2.0-only
config SPRD_PIKE2_SLEEP
        bool "Spreadtrum light sleep driver for pike2 processors"
        depends on ARM_SPRD_CPUIDLE

        help
        Select this to enable light sleep function for pike2 soc.

config SPRD_PMIC_REFOUT
	tristate "Spreadtrum PMIC refout driver"
	depends on MFD_SC27XX_PMIC || COMPILE_TEST
	
	help
		Enable this configuration option to enable pmic refout driver.

source "drivers/soc/sprd/domain/Kconfig"
```

## drivers/soc/sprd/autotest/Kconfig
```kconfig
#
# SPRD Soc autotest support
#
config SPRD_AUTOTEST
	tristate "Spreadtrum autotest support"
	depends on ARCH_SPRD

config SPRD_AUTOTEST_GPIO
	tristate "Spreadtrum gpio autotest support"
	depends on SPRD_AUTOTEST
	select GPIOLIB
	help
	  Enable this to support gpio autotest.

config SPRD_AUTOTEST_PINCTRL
	tristate "Spreadtrum pinctrl autotest support"
	depends on SPRD_AUTOTEST
	select PINCTRL
	help
	  Enable this to support pinctrl autotest.

config SPRD_AUTOTEST_OTG
	tristate "Spreadtrum otg autotest support"
	depends on SPRD_AUTOTEST
	select USB_OTG
	help
	  Enable this to support otg autotest.
```

## drivers/soc/sprd/debug/Kconfig
```kconfig
config SPRD_DEBUG
	bool "Spreadtrum debug module"
	depends on ARCH_SPRD || COMPILE_TEST
	help
	  Say y here to enable Debug support.

config SPRD_LOOK_AT
	tristate "Sprdtrum lookat tool support"
	depends on SPRD_DEBUG || COMPILE_TEST
	default n
	help
	  this macro is for lookat driver, lookat is a debug tool that is used to
	  view the content of arm/arm64 of the address space through usb port,
	  such as the register of each module, DDR address space, etc.
	  When in doubt, say n

config SPRD_PAST_RECORD
	bool "SPRD past event debug"
	depends on SPRD_DEBUG
	default y
	help
	  SPRD past record for Debug.

config ENABLE_SPRD_IO_TRACING
	bool "SPRD IO TRACING event debug"
	depends on SPRD_DEBUG
	default y
	help
	  SPRD IO TRACING for Debug.

config ENABLE_SPRD_DEEP_SLEEP_TRACING
	bool "SPRD deep sleep debug"
	depends on SPRD_DEBUG
	default y
	help
	  SPRD deep sleep TRACING for Debug. For user version, say no.

source "drivers/soc/sprd/debug/djtag/Kconfig"
source "drivers/soc/sprd/debug/busmonitor/Kconfig"
source "drivers/soc/sprd/debug/sysdump/Kconfig"
source "drivers/soc/sprd/debug/dmc_mpu/Kconfig"
source "drivers/soc/sprd/debug/hang_debug/Kconfig"
source "drivers/soc/sprd/debug/log/Kconfig"
source "drivers/soc/sprd/debug/userspace_debug/Kconfig"
source "drivers/soc/sprd/debug/apb_prot/Kconfig"

config SPRD_LAST_REGS
	bool "SPRD last regs access"
	depends on SPRD_DEBUG
	default n
	help
	  SPRD last regs access for Debug.
source "drivers/soc/sprd/debug/irq/Kconfig"
```

## drivers/soc/sprd/debug/hang_debug/Kconfig
```kconfig
config SPRD_HANG_DEBUG
	bool "Enable SPRD hang debug feature"
	default n
	help
	  This option enables SPRD hang debug feature which dump and
	  print debug info when kernel panics.

config SPRD_HANG_WDF
	tristate "Enable SPRD hang debug wdf feature"
	depends on SPRD_HANG_DEBUG
	default m
	help
	  This option enables SPRD hang debug wdf feature.

config SPRD_HANG_WDH
	bool "Enable SPRD hang debug wdh feature"
	depends on SPRD_HANG_DEBUG
	default y
	help
	  This option enables SPRD hang debug wdh feature.

config SPRD_HANG_DEBUG_UART
	bool "sprd hang debug using uart for log output"
	depends on SPRD_HANG_DEBUG && SERIAL_SPRD_CONSOLE
	default y

config SPRD_HANG_RESET
	bool "trigger cm4 handling ap watchdog reset"
	depends on SPRD_HANG_DEBUG
	default y

config SPRD_HANG_TRIGGER
	bool "supply a driver for trigger AP cpu hang"
	depends on SPRD_HANG_DEBUG
	default y
```

## drivers/soc/sprd/debug/irq/Kconfig
```kconfig
config SPRD_EIRQSOFF
	bool "spreadtrum IRQ disable time debug"
	depends on IRQSOFF_TRACER && SPRD_DEBUG
	default n
```

## drivers/soc/sprd/debug/log/Kconfig
```kconfig
config SPRD_USERLOG
	tristate "Enable SPRD user log feature"
	depends on SPRD_DEBUG
	default n
	help
	  This option enables SPRD log feature for user log point.
```

## drivers/soc/sprd/debug/sysdump/Kconfig
```kconfig
config SPRD_SYSDUMP
	bool "Enable SPRD sysdump handler"
	help
		This option enables Spreatrum sysdump which prepare debug info
		for u-boot to write into mmc storage after kernel panics.
```

## drivers/soc/sprd/domain/Kconfig
```kconfig
# SPDX-License-Identifier: GPL-2.0
config SPRD_POWER_DOMAIN
	tristate "SPRD Power Domain"
	depends on ARCH_SPRD || COMPILE_TEST
	select PM_GENERIC_DOMAINS if PM
	help
	  When you select this feature, it will enable the pm generic
	  power domain for sprd power domain module.

config SPRD_VSP_PW_DOMAIN
	tristate "SPRD vsp power domain"
	depends on ARCH_SPRD || COMPILE_TEST
	select PM_GENERIC_DOMAINS if PM
	help
	  When you select this feature, it will enable the vsp power domain.

config SPRD_VPU_PW_DOMAIN
	tristate "SPRD vpu power domain"
	depends on ARCH_SPRD
	help
	   Say Y here if you want to build a driver for vpu device for qogirn6pro;
	   otherwise, N.

config SPRD_DISP_PM_DOMAIN_SHARKL3
	tristate "SPRD Display PM Generic Domain for SharkL3"
	default m
	depends on ARCH_SPRD || COMPILE_TEST
	select PM_GENERIC_DOMAINS if PM
	help
	  When you select this feature, it will enable the pm generic
	  power domain for SharkL3 display module.
```

## drivers/soc/sprd/modem/Kconfig
```kconfig
#
# SPRD MODEM drivers
#
source "drivers/soc/sprd/modem/iq/Kconfig"
source "drivers/soc/sprd/modem/sipc/Kconfig"
source "drivers/soc/sprd/modem/power_manager/Kconfig"
```

## drivers/soc/sprd/modem/crypto/Kconfig
```kconfig
config SPRD_CRYPTO
	tristate "Spreadtrum Crypto Driver for verifying modem image"
	default n
	help
	  spreadtrum crypto driver for verifying modem image.

config SPRD_CRYPTO_TEST
	tristate "The Testing option of Spreadtrum Crypto Driver for verifying modem image"
	default n
	help
	  The Testing option of spreadtrum crypto driver for verifying modem image.
```

## drivers/soc/sprd/modem/iq/Kconfig
```kconfig
menu "SPRD IQ modules"

config SPRD_IQ
	tristate "Sprd IQ"
	default n
	help
	  Sprd IQ module, capture the iq data.

endmenu
```

## drivers/soc/sprd/modem/power_manager/Kconfig
```kconfig
config SPRD_MODEM_POWER_MANAGER
	tristate "SPRD Modem Power Manager"
	depends on PM_SLEEP
	default n
	help
	  SPRD modem power manager. It be user for modem power management,
```

## drivers/soc/sprd/modem/sipc/Kconfig
```kconfig
menu "SPRD SIPC modules"

config SPRD_SIPC
	tristate "Sprd IPC support"
	depends on SPRD_MBOX || UNISOC_MAILBOX
	select SPRD_MODEM_POWER_MANAGER
	default n
	help
	  SIPC is a module for spreadtrum AP/CP communicaiton system,
	  This driver is a SIPC V3 driver, it is base to SIPC v2 dirver.
	  depends on MBOX.

	  Say M here if you want to build a module.

config SPRD_SIPC_SPIPE
	tristate "SPRD pipe driver based on SBUF"
	default n
	depends on SPRD_SIPC
	help
	  This driver is a pipe driver base on SBUF, which create
	  general pipes between AP & CP.

	  Say M here if you want to build a module.

config SPRD_SIPC_SPOOL
	tristate "SPRD pool driver based on SBLOCK"
	default n
	depends on SPRD_SIPC
	help
	  This driver is a pool driver base on SBLOCK, which create
	  general pools between AP & CP.

	  Say M here if you want to build a module.

config SPRD_SIPC_SLOG_BRIDGE
	tristate "SPRD slog bridge driver based on SIPC"
	default n
	depends on SPRD_SIPC
	help
	  This driver is a slog bridge driver base on SIPC, which create
	  slog bridge .

	  Say M here if you want to build a module.

config SPRD_SIPC_SBUF_BRIDGE
	tristate "SPRD sbuf bridge driver based on SIPC"
	default n
	depends on SPRD_SIPC
	help
	  This driver is a slog bridge driver base on SIPC, which create
	  sbuf bridge .

	  Say M here if you want to build a module.

config SPRD_SIPC_SBLOCK_BRIDGE
	tristate "SPRD sblock bridge driver based on SIPC"
	default n
	depends on SPRD_SIPC
	help
	  This driver is a sblock bridge driver base on SIPC, which create
	  sblock bridge .

	  Say M here if you want to build a module.

config SPRD_SIPC_ZERO_COPY_SIPX
	tristate "SPRD SIPX driver"
	default n
	depends on SPRD_SIPC
	help
	  SIPX driver implementation for the Spreadtrum platform.
	  It is used to provide read/write application program interface.
	  It can transmit large blocks data and IP packets based on sblock.

	  Say M here if you want to build a module.

config SPRD_SIPC_MEM_CACHE_EN
	bool "Enable cache from sipc memory"
	default n
	depends on SPRD_SIPC_ZERO_COPY_SIPX
	help
	  Enable cache from sipc memory.

config SPRD_SIPC_WCN
	bool "Enable sipc for WCN"
	default n
	depends on SPRD_SIPC
	help
	  This option enables sipc interface for WCN.
endmenu
```

## drivers/soc/sprd/performance/Kconfig
```kconfig
config SPRD_PTM
	bool "Spreadtrum Performance Trace Monitor Support"
	depends on SPRD_DEBUG
	help
	  Say Y here to support ptm support.

config SPRD_PTM_DIFF_R6P1
        bool "Spreadtrum Performance Trace Monitor Support Diff Above R6P1"
        depends on SPRD_PTM
        help
          Say Y here to support ptm r6p1.
```

## drivers/soc/sprd/power/Kconfig
```kconfig
source "drivers/soc/sprd/power/power_debug/Kconfig"
source "drivers/soc/sprd/power/power_stat/Kconfig"
```

## drivers/soc/sprd/power_debug/Kconfig
```kconfig
#
# SPRD Soc power debug drivers
#
menuconfig SPRD_POWER_DEBUG
	tristate "Spreadtrum power debug driver"
	depends on PM_SLEEP && ARCH_SPRD
	default y
	help
	Select this to enable power debug log driver for sprd soc. This driver
	is only used to output the power state, wakeup interrupt and some specific
	register values before the system enter deep sleep mode. and output the
	power state and wakeup source information in sprd_pm_thread every 30s.
	These logs will help to analysis system power issue.

if SPRD_POWER_DEBUG

config SPRD_SHARKLE_POWER_DEBUG
	tristate "Spreadtrum sharkle power debug"
	depends on SPRD_POWER_DEBUG

config SPRD_PIKE2_POWER_DEBUG
	tristate "Spreadtrum pike2 power debug"
	depends on SPRD_POWER_DEBUG

config SPRD_SHARKL3_POWER_DEBUG
	tristate "Spreadtrum sharkl3 power debug"
	depends on SPRD_POWER_DEBUG

config SPRD_SHARKL5_POWER_DEBUG
	tristate "Spreadtrum sharkl5 power debug"
	depends on SPRD_POWER_DEBUG

config SPRD_SHARKL5PRO_POWER_DEBUG
	tristate "Spreadtrum sharkl5pro power debug"
	depends on SPRD_POWER_DEBUG

config SPRD_ROC1_POWER_DEBUG
	tristate "Spreadtrum roc1 power debug"
	depends on SPRD_POWER_DEBUG

config SPRD_ORCA_POWER_DEBUG
	tristate "Spreadtrum orca power debug"
	depends on SPRD_POWER_DEBUG

config SPRD_SharkL6_POWER_DEBUG
	tristate "Spreadtrum sharkl6 power debug"
	depends on SPRD_POWER_DEBUG

config SPRD_SharkL6Pro_POWER_DEBUG
	tristate "Spreadtrum sharkl6pro power debug"
	depends on SPRD_POWER_DEBUG

endif #SPRD_POWER_DEBUG
```

## drivers/soc/sprd/power_stat/Kconfig
```kconfig
#
# SPRD Soc power statistics
#

menuconfig SPRD_POWER_STAT
	tristate "Spreadtrum debug power stat output"
	depends on ARCH_SPRD
	help
	  Select this to enable debug power stat driver for sprd soc.

if SPRD_POWER_STAT

config SPRD_POWER_STAT_CORE
	tristate "driver core for debug power statistics"
	depends on SPRD_POWER_STAT
	help
	  This add the power state core output function for
	  unisoc paltform.

config SPRD_POWER_STAT_SHARKL6PRO
	tristate "SharkL6Pro debug power statistics"
	depends on SPRD_POWER_STAT && SPRD_POWER_STAT_CORE
	help
	  This add the power state output function for
	  sharkl6pro.

config SPRD_POWER_STAT_SHARKL6
	tristate "SharkL6 debug power statistics"
	depends on SPRD_POWER_STAT && SPRD_POWER_STAT_CORE
	help
	  This add the power state output function for
	  sharkl6.

config SPRD_POWER_STAT_SHARKL5PRO
	tristate "SharkL5Pro debug power statistics"
	depends on SPRD_POWER_STAT && SPRD_POWER_STAT_CORE
	help
	  This add the power state output function for
	  sharkl5pro.

config SPRD_POWER_STAT_SHARKL5
	tristate "SharkL5 debug power statistics"
	depends on SPRD_POWER_STAT && SPRD_POWER_STAT_CORE
	help
	  This add the power state output function for
	  sharkl5.

config SPRD_POWER_STAT_SHARKL3
	tristate "SharkL3 debug power statistics"
	depends on SPRD_POWER_STAT && SPRD_POWER_STAT_CORE
	help
	  This add the power state output function for
	  sharkl3.

config SPRD_POWER_STAT_SHARKLE
	tristate "SharkLE debug power statistics"
	depends on SPRD_POWER_STAT && SPRD_POWER_STAT_CORE
	help
	  This add the power state output function for
	  sharkle.

config SPRD_POWER_STAT_PIKE2
	tristate "Pike2 debug power statistics"
	depends on SPRD_POWER_STAT && SPRD_POWER_STAT_CORE
	help
	  This add the power state output function for
	  pike2.

endif #SPRD_POWER_STAT
```
