/*
 * Spreadtrum Pike2 SP7731e DTS file
 *
 * Copyright (C) 2019-2020, Spreadtrum Communications Inc.
 *
 * This file is licensed under a dual GPLv2 or X11 license.
 */

#include <dt-bindings/gpio/gpio.h>
#include "sc7731e.dtsi"
#include "sc7731e-wcn.dtsi"
#include "sc2720.dtsi"
#include "sprd-sound.dtsi"
#include "sp7731e-mach.dtsi"

/ {
	model = "Spreadtrum Pike2 SC7731e SoC";

	compatible = "sprd,sc7731e";

	sprd,sc-id = "sp7731e 1000 1000";

	memory: memory@80000000 {
		device_type = "memory";
		reg = <0x80000000 0x40000000>;
	};
};

