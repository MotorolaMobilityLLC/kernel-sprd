// SPDX-License-Identifier: (GPL-2.0+ OR MIT)
/*
 * Unisoc Sharkl3 platform L3R SOC DVFS DTS file
 *
 * Copyright (C) 2019, Unisoc Communications Inc.
 */

#include "sc9863a.dtsi"

&cpufreq_clus0 {
	/* operating-points-SC9863A1-0-0
	 * SC9863A1/SC9863A-soc_ver 0-binning 0-temp
	 */
	operating-points-SC9863A1 = <
		/* kHz	uV */
		1200000 1200000
		1100000	1159375
		1000000	1103125
		884000	1046875
		768000	987500>;
	operating-points-SC9863A1-1 = <
		/* kHz	uV */
		1200000 1034375
		1100000	987500
		1000000	931250
		884000	900000
		768000	900000>;
	operating-points-SC9863A1-2 = <
		/* kHz	uV */
		1200000 1090625
		1100000	1043750
		1000000	987500
		884000	931250
		768000	900000>;
	operating-points-SC9863A1-3 = <
		/* kHz	uV */
		1200000 1143750
		1100000	1100000
		1000000	1043750
		884000	987500
		768000	925000>;
	operating-points-SC9863A1-4 = <
		/* kHz	uV */
		1200000 1200000
		1100000	1159375
		1000000	1103125
		884000	1046875
		768000	987500>;
	operating-points-SC9863A1-1-65 = <
		/* kHz	uV */
		1200000 1059375
		1100000	1003125
		1000000	937500
		884000	900000
		768000	900000>;
	operating-points-SC9863A1-2-65 = <
		/* kHz	uV */
		1200000 1115625
		1100000	1062500
		1000000	1000000
		884000	934375
		768000	900000>;
	operating-points-SC9863A1-3-65 = <
		/* kHz	uV */
		1200000 1168750
		1100000	1118750
		1000000	1059375
		884000	996875
		768000	928125>;
	operating-points-SC9863A1-4-65 = <
		/* kHz	uV */
		110000	1178125
		100000	1121875
		884000	1059375
		768000	993750>;
};

&cpufreq_clus1 {
	operating-points-SC9863A1 = <
		/* kHz	uV */
		1600000 1200000
		1500000	1162500
		1400000	1125000
		1225000	1056250
		1050000	987500
		768000	900000>;
	operating-points-SC9863A1-1 = <
		/* kHz	uV */
		1600000 1068750
		1500000	1025000
		1400000	984375
		1225000	909375
		1050000	900000
		768000	900000>;
	operating-points-SC9863A1-2 = <
		/* kHz	uV */
		1600000	1112500
		1500000	1068750
		1400000	1031250
		1225000	962500
		1050000	900000
		768000	900000>;
	operating-points-SC9863A1-3 = <
		/* kHz	uV */
		1600000	1150000
		1500000	1112500
		1400000	1078125
		1225000	1012500
		1050000	946875
		768000	900000>;
	operating-points-SC9863A1-4 = <
		/* kHz	uV */
		1600000 1200000
		1500000	1162500
		1400000	1125000
		1225000	1056250
		1050000	987500
		768000	900000>;
	operating-points-SC9863A1-1-65 = <
		/* kHz	uV */
		1600000	1093750
		1500000	1043750
		1400000	996875
		1225000	912500
		1050000	900000
		768000	900000>;
	operating-points-SC9863A1-2-65 = <
		/* kHz	uV */
		1600000	1137500
		1500000	1090625
		1400000	1046875
		1225000	968750
		1050000	900000
		768000	900000>;
	operating-points-SC9863A1-3-65 = <
		/* kHz	uV */
		1600000 1175000
		1500000	1134375
		1400000	1093750
		1225000	1025000
		1050000	953125
		768000	900000>;
	operating-points-SC9863A1-4-65 = <
		/* kHz	uV */
		1500000 1184375
		1400000	1143750
		1225000	1068750
		1050000	996875
		768000	900000>;
};

&cpufreq_fcm {
	operating-points-SC9863A1 = <
		/* kHz	uV */
		1250000 1200000
		1172000	1162500
		1095000	1125000
		959000	1056250
		824000	987500
		768000	900000>;
	operating-points-SC9863A1-1 = <
		/* kHz	uV */
		1250000	1068750
		1172000	1025000
		1095000	984375
		959000	909375
		824000	900000
		768000	900000>;
	operating-points-SC9863A1-2 = <
		/* kHz	uV */
		1250000	1112500
		1172000	1068750
		1095000	1031250
		959000	962500
		824000	900000
		768000	900000>;
	operating-points-SC9863A1-3 = <
		/* kHz	uV */
		1250000	1150000
		1172000	1112500
		1095000	1078125
		959000	1012500
		824000	946875
		768000	900000>;
	operating-points-SC9863A1-4 = <
		/* kHz	uV */
		1250000 1200000
		1172000	1162500
		1095000	1125000
		959000	1056250
		824000	987500
		768000	900000>;
	operating-points-SC9863A1-1-65 = <
		/* kHz	uV */
		1250000	1093750
		1172000	1043750
		1095000	996875
		959000	912500
		824000	900000
		768000	900000>;
	operating-points-SC9863A1-2-65 = <
		/* kHz	uV */
		1250000	1137500
		1172000	1090625
		1095000	1046875
		959000	968750
		824000	900000
		768000	900000>;
	operating-points-SC9863A1-3-65 = <
		/* kHz	uV */
		1250000 1175000
		1172000	1134375
		1095000	1093750
		959000	1025000
		824000	953125
		768000	900000>;
	operating-points-SC9863A1-4-65 = <
		/* kHz	uV */
		1172000 1184375
		1095000	1143750
		959000	1068750
		824000	996875
		768000	900000>;
};

