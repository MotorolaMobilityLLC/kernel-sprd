/ {
    fragment {
        target-path = "/";
        __overlay__ {
            fps_fpsensor {
                compatible = "sprd,fingerprint-fpsensor";
                fpsensor,eint-gpio   = <&ap_gpio 130 0 >;
                fpsensor,reset-gpio  = <&ap_gpio 131 0 >;
            };
        };
    };
};
