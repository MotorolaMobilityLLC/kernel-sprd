// SPDX-License-Identifier: GPL-2.0-only
&wcn_btwf {
	sprd,gnss-cp-start-addr = <0x40A20000>;
	sprd,gnss-firmware-max-size = <0x58000>;
	sprd,gnss-dump-packet-size = <0x400>;

	sprd,gnss-dump-reg-number = <4>;

	sprd,gnss-share-memory-size = <0x200000>;
	sprd,gnss-dump-iram-start-addr = <0x40A50000>;
	sprd,gnss-cp-iram-data-num = <0x2000>;
};

&wcn_gnss {
	sprd,gnss-cp-start-addr = <0x40A20000>;
	sprd,gnss-firmware-max-size = <0x58000>;
	sprd,gnss-dump-packet-size = <0x400>;

	sprd,gnss-dump-reg-number = <4>;

	sprd,gnss-share-memory-size = <0x200000>;
	sprd,gnss-dump-iram-start-addr = <0x40A50000>;
	sprd,gnss-cp-iram-data-num = <0x2000>;
};
