/*
 * UNISOC UMP9622 PMIC dts file
 *
 * Copyright (C) 2020, UNISOC Communications Inc.
 *
 * SPDX-License-Identifier: (GPL-2.0+ OR MIT)
 */

 &adi_bus {
	ump9622_pmic: pmic@c000 {
		compatible = "sprd,ump9622";
		reg = <0xc000>;
		spi-max-frequency = <26000000>;
		#address-cells = <1>;
		#size-cells = <0>;

		/* ump9622 salve id is 0xC000 */
		syscon@2000 {
			compatible = "sprd,ump96xx-syscon";
			reg = <0x2000>;
		};
	};
};
