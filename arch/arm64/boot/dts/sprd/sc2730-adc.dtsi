// SPDX-License-Identifier: (GPL-2.0+ OR MIT)
/*
 * DTS file of adc in Spreadtrum SC2730 PMIC.
 *
 * Copyright (C) 2020, Spreadtrum Communications Inc.
 *
 */

&pmic0 {
	pmic_adc: adc@504 {
		compatible = "sprd,sc27xx-adc", "sprd,sc2730-adc";
		reg = <0x504>;
		interrupt-parent = <&pmic0>;
		interrupts = <0 IRQ_TYPE_LEVEL_HIGH>;
		#io-channel-cells = <1>;
		hwlocks = <&hwlock 4>;
		nvmem-cells = <&adc_bcal>, <&adc_scal>;
		nvmem-cell-names = "big_scale_calib", "small_scale_calib";
	};
};
