// SPDX-License-Identifier: (Licenseref-Unisoc-General-1.0 OR GPL-2.0-only)
/*
* ums9230-spi3-gpio144-145-tp.dtsi - Unisoc platform device
*
* Copyright 2022 Unisoc(Shanghai) Technologies Co.Ltd
*
* Licensed under the Unisoc General Software License, version 1.0 (the
* License);
 * you may not use this file except in compliance with the License.
 * You may obtain a copy of the License at
 * https://www.unisoc.com/en_us/license/UNISOC_GENERAL_LICENSE_V1.0-EN_US
 * Software distributed under the License is distributed on an "AS IS" BASIS,
 * WITHOUT WARRANTIES OF ANY KIND, either express or implied.
* See the Unisoc General Software License, version 1.0 for more details.
*
* Alternatively you can use and distribute this file under the terms of the
 * GNU General Public License version 2, provided that it has to be used
*  (including but not limited to combining, linking) with any other file under
* the GNU General Public License version 2 on platforms that use Unisoc Chips.
*/

&spi3 {
	status = "ok";
	#address-cells = <1>;
	#size-cells = <0>;

	/* Novatek device tree node */
	touchpanel@0 {
		compatible = "chipone-tddi","tchip,ilitek","omnivision,tcm-spi";
		reg = <0>; //Same as CS ID
		status = "ok";
		spi-max-frequency = <8000000>;	//4800000,9600000,15000000,19200000

		/*------------------focaltech_ft8756------------------*/
		focaltech,max-touch-number = <5>;
		focaltech,display-coords =  <0 0 1080 2400>;
		//spi-max-frequency = <6000000>;
		focaltech,reset-gpio = <&ap_gpio 145 GPIO_ACTIVE_HIGH>;
		focaltech,irq-gpio = <&ap_gpio 144 GPIO_ACTIVE_HIGH>;
		/**********************icnl9916c***********************/

                chipone,rst-gpio = <&ap_gpio 145 GPIO_ACTIVE_HIGH>;
                chipone,irq-gpio = <&ap_gpio 144 GPIO_ACTIVE_HIGH>;
                chipone,x-res = <720>;
                chipone,y-res = <1600>;
		/* Charger detect */
                chipone,touch-charger-detect-enable;
                chipone,touch-charger-detect-type = "notify"; /* notify, poll */
                chipone,touch-charger-detect-psy-name = "charger";
                chipone,touch-charger-detect-psp = "POWER_SUPPLY_PROP_ONLINE";
                chipone,touch-charger-detect-psp-poll-interval = <1000>;
                /* Earjack detect */
                chipone,touch-earjack-detect-enable;
                /* MTK:  /sys/bus/platform/drivers/Accdet_Driver/state,
                   Sprd: /sys/kernel/headset/state
                   QCOM: None, and disable it */
                chipone,touch-earjack-state-filepath = "/sys/bus/platform/drivers/Accdet_Driver/state";
                chipone,touch-earjack-poll-interval = <1000>;
                /* For tp selftest */
                chipone,test-reset-pin;
                chipone,test-int-pin;
                chipone,test-rawdata;
                chipone,test-rawdata-frames      = <1>;
                chipone,rawdata-min              = <100>;
                chipone,rawdata-max              = <10000>;
                chipone,test-noise;
                chipone,test-noise-frames        = <50>;
                chipone,noise-max                = <1000>;
                chipone,test-open;
                chipone,open-min                 = <200>;
                chipone,test-short;
                chipone,short-min                = <200>;
                chipone,test-compensate-cap;
                chipone,compensate-cap-min       = <1>;
                chipone,compensate-cap-max       = <127>;
                /* gesture data test */
                chipone,test-gesture-rawdata;
                chipone,test-gesture-rawdata-frames = <1>;
                chipone,gesture-rawdata-min = <100>;
                chipone,gesture-rawdata-max = <10000>;
                chipone,test-gesture-lp-rawdata;
                chipone,test-gesture-lp-rawdata-frames = <1>;
                chipone,gesture-lp-rawdata-min = <100>;
                chipone,gesture-lp-rawdata-max = <10000>;
                chipone,test-gesture-noise;
                chipone,test-gesture-noise-frames = <50>;
                chipone,gesture-noise-max = <1000>;
                chipone,test-gesture-lp-noise;
                chipone,test-gesture-lp-noise-frames = <50>;
                chipone,gesture-lp-noise-max = <1000>;

		/*------------------ili9883c_spi------------------*/
		touch,reset-gpio = <&ap_gpio 145 GPIO_ACTIVE_HIGH>;
		touch,irq-gpio = <&ap_gpio 144 GPIO_ACTIVE_HIGH>;
		touch,eic-irq-gpio = <&eic_async 16 GPIO_ACTIVE_HIGH>;
		/***************omnivision*****************/
		omnivision,reset-gpio = <&ap_gpio 145 GPIO_ACTIVE_LOW>;
		omnivision,irq-gpio = <&ap_gpio 144 GPIO_ACTIVE_LOW>;
		omnivision,irq-on-state = <0>;
		omnivision,reset-on-state = <0>;
		omnivision,reset-active-ms = <20>;
		omnivision,reset-delay-ms = <200>;
		omnivision,power-delay-ms = <200>;
		omnivision,spi-mode = <3>;
		omnivision,byte-delay-us = <0>;
		omnivision,block-delay-us = <0>;
		omnivision,ubl-max-freq = <8000000>;
		omnivision,ubl-byte-delay-us = <20>;
		/*------------------novatek------------------*/
		//novatek,pen-support;
		//novatek,wgp-stylus;

		novatek,reset-gpio = <&ap_gpio 145 GPIO_ACTIVE_HIGH>;
		novatek,irq-gpio = <&ap_gpio 144 GPIO_ACTIVE_HIGH>;
		/* 525 */
		//novatek,swrst-n8-addr = <0x01F01A>;

		/* 672A, 525B, 675, 526, 672C, 523 */
		novatek,swrst-n8-addr = <0x03F0FE>;
		novatek,spi-rd-fast-addr = <0x03F310>;

		/* MP */
		//novatek,mp-support-dt;

		#include "nvt-touchscreen-novatek-nt36xxx-spi.dtsi"
	};
};
