&spi3 {
	status = "ok";
	#address-cells = <1>;
	#size-cells = <0>;

	/* ILITEK device tree node */
	touchpanel@0 {
		compatible = "tchip,ilitek";
		reg = <0>; //Same as CS ID
		status = "ok";

		/*------------------ilitek_9882q------------------*/
		spi-max-frequency = <10000000>;	
		touch,reset-gpio = <&ap_gpio 145 GPIO_ACTIVE_HIGH>;
		touch,irq-gpio = <&ap_gpio 144 GPIO_ACTIVE_HIGH>;
	};
};
