/*
 * Spreadtrum SC2721 PMIC dts file
 *
 * Copyright (C) 2020, Spreadtrum Communications Inc.
 *
 * SPDX-License-Identifier: (GPL-2.0+ OR MIT)
 */

&adi_bus {
	sc2721_pmic: pmic@0 {
		compatible = "sprd,sc2721";
		reg = <0>;
		spi-max-frequency = <26000000>;
		interrupts = <GIC_SPI 38 IRQ_TYPE_LEVEL_HIGH>;
		interrupt-controller;
		#interrupt-cells = <1>;
		#address-cells = <1>;
		#size-cells = <0>;

		pmic_eic: gpio-controller@280 {
			compatible = "sprd,sc2731-eic", "sprd,sc2721-eic";
			reg = <0x280>;
			interrupt-parent = <&sc2721_pmic>;
			interrupts = <4>;
			gpio-controller;
			#gpio-cells = <2>;
			interrupt-controller;
			#interrupt-cells = <2>;
		};
	};
};
