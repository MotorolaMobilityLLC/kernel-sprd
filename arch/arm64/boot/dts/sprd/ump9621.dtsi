/*
 * UNISOC UMP9621 PMIC dts file
 *
 * Copyright (C) 2020, UNISOC Communications Inc.
 *
 * SPDX-License-Identifier: (GPL-2.0+ OR MIT)
 */

 &adi_bus {
	ump9621_pmic: pmic@2 {
		compatible = "sprd,ump9621";
		reg = <0x1>;
		spi-max-frequency = <26000000>;
		interrupt-controller;
		#interrupt-cells = <1>;
		#address-cells = <1>;
		#size-cells = <0>;
		/* ump9621 salve id is 0x8000 */

		syscon@a000 {
			compatible = "sprd,ump96xx-syscon";
			reg = <0xa000>;
		};
	};
};