// SPDX-License-Identifier: GPL-2.0-only
/ {
	fragment {
		target-path = "/";
		__overlay__ {
			sprd-marlin3 {

	sprd,gnss-cp-start-addr = <0x40A50000>;
	sprd,gnss-firmware-max-size = <0x2B000>;
	sprd,gnss-dump-packet-size = <0x8000>;  //32*1024

	sprd,gnss-dump-reg-number = <4>;
			};
		};
	};
};
