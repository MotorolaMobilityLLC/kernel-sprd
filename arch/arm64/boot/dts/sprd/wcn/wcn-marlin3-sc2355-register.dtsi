// SPDX-License-Identifier: GPL-2.0-only
/ {
	fragment {
		target-path = "/";
		__overlay__ {
			sprd-marlin3 {

	sprd,gnss-cp-start-addr = <0x40A20000>;
	sprd,gnss-firmware-max-size = <0x58000>;

	sprd,gnss-dump-reg-number = <4>;
			};
		};
	};
};
