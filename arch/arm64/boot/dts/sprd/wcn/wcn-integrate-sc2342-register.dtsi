// SPDX-License-Identifier: GPL-2.0-only
/ {
	fragment {
		target-path = "/";
		__overlay__ {
			cpwcn-btwf {

	sprd,gnss-cp-start-addr = <0x40A20000>;
	sprd,gnss-firmware-max-size = <0x58000>;
	sprd,gnss-dump-packet-size = <0x400>;

	sprd,gnss-dump-reg-number = <8>;

	sprd,gnss-share-memory-size = <0x15A800>;
	sprd,gnss-dump-iram-start-addr = <0x18000000>;
	sprd,gnss-cp-iram-data-num = <0x2000>;
			};
		};
	};
};
