&reserved_memory {
	/* Encrypt and decrypt widevine video */
	oemcrypto_reserved: oemcrypto@b4100000 {
		reg = <0x0 0xb4100000 0x0 0x01100000>;
	};

	/* reserved CMA 360MB for widevine*/
	widevine_reserved: widevine@d9800000 {
		compatible = "shared-dma-pool";
		reg = <0x0 0xd9800000 0x0 0x16800000>;
		reusable;
	};

	fd_reserved: faceid-mem@ff9f0000 {
		reg = <0x0 0xff9f0000 0x0 0x00500000>;
	};
};

