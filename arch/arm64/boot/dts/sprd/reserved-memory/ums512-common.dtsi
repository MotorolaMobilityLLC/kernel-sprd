#include "modem-4g-common.dtsi"

&reserved_memory {
	audio_reserved: audio-mem@87400000 {
		reg = <0x0 0x87400000 0x0 0x00400000>;
	};

	sp_ddr_reserved: sp_ddr-mem@88000000 {
		reg = <0x0 0x88000000 0x0 0x00300000>;
	};

	audiodsp_reserved: audiodsp-mem@88f00000 {
		reg = <0x0 0x88f00000 0x0 0x00700000>;
	};

};
