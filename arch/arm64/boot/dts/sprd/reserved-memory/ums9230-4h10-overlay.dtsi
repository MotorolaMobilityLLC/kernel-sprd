// SPDX-License-Identifier: (GPL-2.0+ OR MIT)
&reserved_memory {
	oemcrypto_reserved: oemcrypto@b6100000 {
		reg = <0x0 0xb6100000 0x0 0x01100000>;
	};

	/*Set 8M after widevine to prevent memory out of bounds*/
	widevine_reserved: widevine@de800000 {
		compatible = "shared-dma-pool";
		reg = <0x0 0xde800000 0x0 0x11800000>;
		reusable;
	};

	fd_reserved: faceid-mem@ffa70000 {
		reg = <0x0 0xffa70000 0x0 0x00500000>;
	};
};
