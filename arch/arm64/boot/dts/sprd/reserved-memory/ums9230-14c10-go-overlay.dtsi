// SPDX-License-Identifier: (GPL-2.0+ OR MIT)
&reserved_memory {
	/* double logo_reserved memory size to support buffer swap in LK */
	logo_reserved: logobuffer@9caa8000 {
		reg = <0x0 0x9caa8000 0x0 0x013d8000>;
	};

	fd_reserved: faceid-mem@ffa70000 {
		reg = <0x0 0xffa70000 0x0 0x00500000>;
	};
};
