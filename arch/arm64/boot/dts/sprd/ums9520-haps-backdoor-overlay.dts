/dts-v1/;
/plugin/;

/ {
	model = "Unisoc UMS9520 Haps Backdoor Board";

	compatible = "sprd,ums9520-haps-backdoor";

	sprd,sc-id = "ums9520-haps backdoor 1000";
};

&chosen {
	bootargs = "earlycon console=ttyS1,115200n8 loglevel=7 init=/init root=/dev/ram0 rw androidboot.hardware=ums9520_haps androidboot.dtbo_idx=0 printk.devkmsg=on androidboot.boot_devices=memdisk0 androidboot.selinux=permissive androidboot.force_normal_boot=1";
};
