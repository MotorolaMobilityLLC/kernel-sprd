// SPDX-License-Identifier: (GPL-2.0+ OR MIT)
/*
 * Spreadtrum SC2730 PMIC dts file
 *
 * Copyright (C) 2020, Spreadtrum Communications Inc.
 *
 */

&adi_bus {
	pmic0: pmic@0 {
		compatible = "sprd,sc2730";
		reg = <0>;
		spi-max-frequency = <26000000>;
		interrupt-controller;
		#interrupt-cells = <1>;
		interrupts = <GIC_SPI 173 IRQ_TYPE_LEVEL_HIGH>;
		#address-cells = <1>;
		#size-cells = <0>;
	};
};

#include "sc2730-efuse.dtsi"
#include "sc2730-modules.dtsi"
