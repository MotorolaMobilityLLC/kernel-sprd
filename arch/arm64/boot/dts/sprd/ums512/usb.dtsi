// SPDX-License-Identifier: (GPL-2.0+ OR MIT)
/*
 * Unisoc USB dts file
 *
 * Copyright (C) 2020, Unisoc Inc.
 *
 */

&aon {
	hsphy: hsphy@323b0000 {
		compatible = "sprd,sharkl5pro-phy";
		sprd,syscon-enable = <&aon_apb_regs>;
		sprd,syscon-anag2 = <&anlg_phy_g2_regs>;
		sprd,vdd-voltage = <3300000>;
		io-channels = <&pmic_adc 30>, <&pmic_adc 31>;
		io-channel-names = "dp", "dm";
		#phy-cells = <0>;
	};

	usb: usb@5fff0000 {
		compatible = "sprd,sharkl5pro-musb";
		reg = <0 0x5fff0000 0 0x2000>;
		interrupts = <GIC_SPI 69 IRQ_TYPE_LEVEL_HIGH>;
		interrupt-names = "mc";
		clocks = <&aonapb_gate CLK_OTG_UTMI_EB>;
		clock-names = "core_clk";
		usb-phy = <&hsphy>;
		phy-names = "usb";
		dr_mode = "otg";
		multipoint = "true";
		wakeup-source;
	};
};
