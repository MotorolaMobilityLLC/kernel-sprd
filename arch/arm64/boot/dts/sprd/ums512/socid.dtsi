#include <dt-bindings/soc/sprd,sharkl5pro-regs.h>
#include <dt-bindings/soc/sprd,sharkl5pro-mask.h>
&aon {
	socid: socid {
		compatible = "sprd,soc-id";
		chip-id = <&aon_apb_regs REG_AON_APB_RF_AON_CHIP_ID0
			MASK_AON_APB_RF_AON_CHIP_ID0>;
		plat-id = <&aon_apb_regs REG_AON_APB_RF_AON_PLAT_ID0
			MASK_AON_APB_RF_AON_PLAT_ID0>;
		implement-id = <&aon_apb_regs REG_AON_APB_RF_AON_IMPL_ID
			MASK_AON_APB_RF_AON_IMPL_ID>;
		manufacture-id = <&aon_apb_regs REG_AON_APB_RF_AON_MFT_ID
			MASK_AON_APB_RF_AON_MFT_ID>;
		version-id = <&aon_apb_regs REG_AON_APB_RF_AON_VER_ID
			MASK_AON_APB_RF_AON_VER_ID>;
	};
};
