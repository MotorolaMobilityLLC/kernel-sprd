/* SPDX-License-Identifier: (GPL-2.0+ OR MIT)
 *
 * Unisoc USB dts file
 *
 * Copyright (C) 2020, Unisoc Inc.
 *
 */

&aon {
	adi_bus: spi@32100000 {
		compatible = "sprd,ums512-adi";
		reg = <0 0x32100000 0 0x100000>;
		#address-cells = <1>;
		#size-cells = <0>;
	};
};
