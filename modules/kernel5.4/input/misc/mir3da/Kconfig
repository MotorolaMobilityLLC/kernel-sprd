## modules/kernel5.4/input/misc/mir3da/Kconfig
```kconfig
config INPUT_MIR3DA
	tristate "MIR3DA"
	depends on I2C=y
	help
	  If you say yes here you get support for miramems's
	  accelerate sensors.
```

## modules/kernel5.4/input/misc/n2dm_accel/Kconfig
```kconfig
#
# Makefile for STMicroelectronics sensor driver.
#
config INPUT_N2DM_I2C
	tristate "STM n2dm acceleration sensor support"
	depends on I2C
	help
	  Say Y here to enable support for the STM's
	  acceleration sensor n2dm.

	  To compile this driver as a module, choose M here: the
	  module will be called n2dm_accel.
```

## modules/kernel5.4/input/misc/stk8baxx/Kconfig
```kconfig
#
# Makefile for stk8baxx sensor driver.
#
config INPUT_STK8BAXX_I2C
	tristate "stk8baxx acceleration sensor support"
	depends on I2C
	help
	  Say Y here to enable support for the stk8baxx's
	  acceleration sensor stk8baxx.

	  To compile this driver as a module, choose M here: the
	  module will be called stk8baxx.
```

## modules/kernel5.4/input/misc/tcs3430/Kconfig
```kconfig
config SENSORS_TCS3430
	tristate "AMS TCS3430 ambient light sensor"
	depends on I2C && SYSFS
	help
	  If you say yes here you get support for the AMS TCS3430
	  ambient light sensor.

	  This driver can also be built as a module.  If so, the module
	  will be called tcs3430.

config SENSORS_TCS3430_WITH_LUX_CCT
	bool "LUX and CCT calculations"
	depends on SENSORS_TCS3430
	default y
	help
	  If you say yes here you get support for the AMS TCS3430
	  ambient light sensor with lux and cct calculated in
          the driver with fixed point arithmetic.
```

## modules/kernel5.4/input/misc/vl53L0/Kconfig
```kconfig
config INPUT_SENSORS_ST_VL53L0
	tristate "VL53L0 device with I2C bus"
	depends on I2C
	default Y
	help
	  Say Y here if you have a VL53L0 device on the board and use I2C
	  communication, else say N.

	  To compile this driver as a module, choose M here.
```

## modules/kernel5.4/input/misc/vl53L1/Kconfig
```kconfig
config INPUT_SENSORS_ST_VL53L1
	tristate "VL53L1 device with I2C bus"
	depends on I2C
	default Y
	help
	  Say Y here if you have a VL53L1 device on the board and use I2C
	  communication, else say N.

	  To compile this driver as a module, choose M here.
```

## modules/kernel5.4/input/touchscreen/adaptive-ts/focaltech_ft6436u/Kconfig
```kconfig
#
# Focaltech Touchscreen driver configuration
#

config TOUCHSCREEN_FTS6436U
    tristate "Focaltech controller definition for adaptive touchscreen"
    depends on I2C || TOUCHSCREEN_ADAPTIVE
    help
      Say y here if you have a FTS6436U based touchscreen controller.
      If unsure, say N.

config TOUCHSCREEN_FTS_DIRECTORY
    string "Focaltech ts directory name"
    default "focaltech_touch"
    depends on TOUCHSCREEN_FTS6436U
```

## modules/kernel5.4/wcn/bluetooth/driver/tty-sipc/Kconfig
```kconfig
#
# Spreadtrum FM drivers
#
config SPRD_WCN_BT
	tristate "BT Support"
	default m
	---help---
	  Say Y to enable built-in BT controller in the
	  Spreadtrum BT based System-on-Chip devices.
```

## modules/kernel5.4/wcn/fm/driver/fm_sdio/Kconfig
```kconfig
#
# Spreadtrum SC2331 FM drivers
#
config RADIO_MARLIN3
	tristate "MARLIN3 FM Support"
	default n
	---help---
	  Say Y to enable built-in FM controller in the
	  Spreadtrum SC2331 based System-on-Chip devices.
```

## modules/kernel5.4/wcn/fm/driver/fm_sipc/Kconfig
```kconfig
#
# Spreadtrum FM drivers
#
config SPRD_WCN_FM
	tristate "FM Support"
	default m
	---help---
	  Say Y to enable built-in FM controller in the
	  Spreadtrum FM based System-on-Chip devices.
```

## sound/soc/sprd/Kconfig
```kconfig
menuconfig SND_SOC_SPRD
	tristate "ASoC Audio for the SPREADTRUM"
	depends on ARCH_SPRD
	help
	  Say Y if you want to build Spreadtrum ASOC card.

if SND_SOC_SPRD

config SND_SOC_SPRD_I2S
	tristate #"ASoC Spreadtrum AP I2S sound card(bypass VBC) support"
	help
	  Say Y if you want to build in to kernel, Say M for ko module.
	  this option will build Spreadtrum AP I2S driver for card bypasses
	  VBC module, e.g. external codec or like BT/Digital FM etc.

config SND_SOC_SPRD_VBC_V4_SC2730
	tristate "ASoC Spreadtrum sound card with vbc v4 and codec sc2730"
	select SPRD_AUDIO_AGDSP_ACCESS
	select SPRD_AUDIO_MEMORY_MANAGER
	select SPRD_AUDIO_SIPC
	select SPRD_AUDIO_MCDT
	select SND_SOC_SPRD_VBC_V4
	select SND_SOC_SPRD_CODEC_SC2730
	select SPRD_AUDIO_DSP_DUMP
	select SND_SOC_COMPRESS
	help
	  Say Y or M here if you want to add support for ASoC audio on
	  Spreadtrum boards using the VBC v4 and the sc2730 codec.
	  ASOC machine with cpu dai vbc v4 and codec dai sc2730.
	  This vbc is in audio cp, so we should select communication config
	  and data transmit config.

config SND_SOC_SPRD_I2S_DUMMY
	tristate "ASoC Spreadtrum sound card with AP I2S and a dummy codec"
	select SND_SOC_SPRD_I2S
	help
	  Say Y or M here if you want to add support for ASoC audio on Spreadtrum
	  boards using the AP I2S and a dummy codec.

source "sound/soc/sprd/dai/vbc/Kconfig"
source "sound/soc/sprd/dai/i2s/Kconfig"
source "sound/soc/sprd/codec/sprd/Kconfig"
endif #SND_SOC_SPRD
```

## sound/soc/sprd/codec/awinic/Kconfig
```kconfig
config SND_SMARTPA_AW881XX
	tristate "SoC Audio for awinic aw881xx series"
	depends on I2C
	help
	  This option enables support for aw881xx series Smart PA.
```

## test/Kconfig
```kconfig
config TEST
	bool
	default y

config TEST_TEST
	bool
	depends on TEST
	default y

config EXAMPLE_TEST
	bool
	depends on TEST
	default y
```
