## drivers/hwtracing/coresight/phy/Kconfig
```kconfig
#
# Physical Layer Coresight PHY driver configuration
#
menu "Coresight Physical Layer drivers"

config CORESIGHT_PHY
	depends on CORESIGHT_TMC_GROUP
	select EXTCON
	def_bool n

config SPRD_SHARKL6PRO_CORESIGHT_PHY
	tristate "Spreadtrum SHARKL6PRO CORESIGHT PHY Driver"
	select CORESIGHT_PHY
	help
	  Enable this to support SHARKL6PRO CORESIGHT PHY that is part of SOC.

endmenu
```

## drivers/iio/sprd_hub_new/Kconfig
```kconfig
#
# SPRD Sensor Hub New drivers configuration
#

menu "Spreadtrum Sensor Hub new"

config SPRD_SENSOR_HUB_NEW
	tristate "Spreadtrum Sensor Hub New"
	select IIO_BUFFER
	select IIO_KFIFO_BUF
	select IIO_TRIGGER
	depends on SPRD_SIPC
	depends on SPRD_SYSTIMER
	help
	  Support Sensor hub new Feature
	  Provide power saving solution for integrating and
	  processing sensor data.

	  Say Y here to build support for sensor hub new.
	  To compile this driver as a module, choose M here

endmenu
```

## drivers/input/fingerprint/Kconfig
```kconfig
#
#Fingerprint
#
menuconfig INPUT_FINGERPRINT
	  tristate "Fingerprint Config Choosen"
	  default y
	  help
	  Say Y to can config finperprint manufacturer

source drivers/input/fingerprint/fps_fpc_S00/Kconfig
source drivers/input/fingerprint/fps_goodix_S00/Kconfig
```

## drivers/input/fingerprint/fps_egis_S00/Kconfig
```kconfig
if INPUT_FINGERPRINT
config FPS_EGIS_S00
	tristate "ET528 fingureprint driver"
	depends on SPI
	default n
	---help---
	  egistec ET528 fingerprint driver.
	  This is a driver based on the SPI kernel layers.

	  To compile this driver as a module, choose m here. The module will
	  be called fpsensor.
	  Say N if unsure.
endif
```

## drivers/input/fingerprint/fps_fpc_S00/Kconfig
```kconfig
config FPS_FPC_S00
        tristate "fpc Finger Print Driver"
        help
          fpc Finger Print Supported
```

## drivers/input/fingerprint/fps_fpsensor_S00/Kconfig
```kconfig
if INPUT_FINGERPRINT
config FPS_FPSENSOR_S00
	tristate "ICNT7152 fingureprint driver"
	depends on SPI
	default n
	---help---
	  chiponeic ICNT7152L fingureprint driver.
	  This is a driver based on the SPI kernel layers.

	  To compile this driver as a module, choose m here. The module will
	  be called fpsensor.
	  Say N if unsure.
endif
```

## drivers/input/fingerprint/fps_goodix_S00/Kconfig
```kconfig
config FPS_GOODIX_S00
    tristate "generic goodix fingerprint driver"
    help
    add support for goodix fingerprint driver.
 
```

## drivers/input/misc/sx933x/Kconfig
```kconfig
#
# Input misc drivers configuration
#

if INPUT_MISC

config INPUT_SX933X
	tristate "SX933x_SAR_sensor"
	depends on I2C
	default y
	help 
	  Say Y to enable the SAR detection application, if N here not to use the 
	  this SAR sensor

endif
```

## drivers/input/sx9338/Kconfig
```kconfig
config INPUT_SX9338
	tristate "SX9338 sar sensor support"
	depends on I2C
	help
	  Say Y here if you have SX9338
	  sar sensor hooked to an I2C bus.

	  To compile this driver as a module, choose M here: the
	  module will be called sx9338.
```

## drivers/input/touchscreen/adaptive-ts/Kconfig
```kconfig
#
# Adaptive touchscreen module
#

config TOUCHSCREEN_ADAPTIVE
    tristate "adaptive touchscreen driver"
    depends on I2C || SPI_MASTER
    help
      Say Y here to use adaptive touchscreen driver.

config CONFIG_TOUCHSCREEN_ADAPTIVE_FOCALTECH
    tristate "Focaltech controller definition for adaptive touchscreen"
    depends on I2C || TOUCHSCREEN_ADAPTIVE
    help
      Say m here if you have a focaltech based touchscreen controller.

      If unsure, say N.

config TOUCHSCREEN_ADAPTIVE_MSTAR
    tristate "MStar controller definition for adaptive touchscreen"
    depends on I2C || TOUCHSCREEN_ADAPTIVE
    help
      Say m here if you have a mstar based touchscreen controller.

      If unsure, say N.

config TOUCHSCREEN_ADAPTIVE_TLSC6X
    tristate "Tlsc6x controller definition for adaptive touchscreen"
    depends on I2C || TOUCHSCREEN_ADAPTIVE
    help
      Say m here if you have a tlsc6x based touchscreen controller.

      If unsure, say N.

config TOUCHSCREEN_ADAPTIVE_NT36XXX
    tristate "Nt36xxx controller definition for adaptive touchscreen"
    depends on I2C || TOUCHSCREEN_ADAPTIVE
    help
      Say y here if you have a nt36xxx based touchscreen controller.
      If unsure, say N.

config TOUCHSCREEN_ADAPTIVE_ILI9882H
    tristate "ILI9882H controller definition for adaptive touchscreen"
    depends on I2C || TOUCHSCREEN_ADAPTIVE
    help
      Say y here if you have a ILI9882H based touchscreen controller.
      If unsure, say N.

config TOUCHSCREEN_ADAPTIVE_ILI9882H_SPI
    tristate "ILI9882H controller definition for adaptive touchscreen"
    depends on I2C || TOUCHSCREEN_ADAPTIVE
    help
      Say y here if you have a ILI9882H based touchscreen controller.
      If unsure, say N.

config TOUCHSCREEN_ADAPTIVE_NT36XXX_SPI
    tristate "Nt36xxx controller definition for adaptive touchscreen"
    depends on I2C || TOUCHSCREEN_ADAPTIVE
    help
      Say y here if you have a nt36xxx based touchscreen controller.
      If unsure, say N.

config TOUCHSCREEN_ADAPTIVE_ICNL9911X
    tristate "icnl9911x controller definition for adaptive touchscreen"
    depends on I2C || TOUCHSCREEN_ADAPTIVE
    help
      Say y here if you have a ICNL9911X based touchscreen controller.
      If unsure, say N.

config TOUCHSCREEN_ADAPTIVE_ICNL9911X_SPI
    tristate "icnl9911x controller definition for adaptive touchscreen"
    depends on I2C || TOUCHSCREEN_ADAPTIVE
    help
      Say y here if you have a ICNL9911X based touchscreen controller.
      If unsure, say N.

config TOUCHSCREEN_ADAPTIVE_FT8722
    tristate "ft8722 controller definition for adaptive touchscreen"
    depends on I2C || TOUCHSCREEN_ADAPTIVE
    help
      Say y here if you have a ICNL9911X based touchscreen controller.
      If unsure, say N.

config TOUCHSCREEN_ADAPTIVE_FT8006AB
    tristate "ft8006_ab controller definition for adaptive touchscreen"
    depends on I2C || TOUCHSCREEN_ADAPTIVE
    help
      Say y here if you have a ICNL9911X based touchscreen controller.
      If unsure, say N.
# if TOUCHSCREEN_ADAPTIVE

# source drivers/input/touchscreen/adaptive-ts/vendors/Kconfig

# endif
```
