## Documentation/devicetree/bindings/soc/sprd/sprd_7sreset.txt
```
Spreadtrum 7sreset bindings

This IP block in the unisoc SoC that only deals with hardware reboot-force.

Required properties:
- compatible:
  -"sprd,sc2720-7sreset" for SC2720 poweroff
  -"sprd,sc2721-7sreset" for SC2721 poweroff
  -"sprd,sc2730-7sreset" for SC2730 poweroff
  -"sprd,sc2731-7sreset" for SC2731 poweroff
  -"sprd,ump9620-7sreset" for UMP9620 poweroff

- reg: Specifies the physical address of the SWRST_CTL0 and POR_7S_CTL register.

Example:
hw-reset@1bc0 {
	compatible = "sprd,sc2730-7sreset";
	reg = <0x1bf8>, <0x1bc0>;
};
```

## Documentation/devicetree/bindings/sound/sprd-audcp-dvfs.txt
```
* Spreadtrum audio cp dvfs

This node models spreadtrum audio cp dvfs

Required properties:

- compatible : "sprd,sharkl5-audcp-dvfs"
- sprd,channel : the channel number for ap and audio co-processor
	communication for dvfs(dynamic voltage and clock freqency).

Example:
audiocp_dvfs {
	compatible = "sprd,sharkl5-audcp-dvfs";
	sprd,channel = <10>;
};
```

## Documentation/devicetree/bindings/sound/sprd-headset.txt
```
* Spreadtrum headset driver

This node models spreadtrum headset driver

Required properties:

- compatible : "sprd,headset",
- sprd,jack-type: headset jack type, normal open/close
- io-channels: adc channel used to read headset adc
- io-channel-names: adc channel name
- gpios: TOP EIC GPIO
- sprd,debounce-interval: headset plugin/plugout debounce time
- gpio-names: the GPIO name of TOP EIC
- sprd,adc-threshold-3pole-detect: threshold value to distinguish 3 pole or 4 pole
- sprd,adc-gnd: GND adc value
- sprd,stable-value: stable adc value
- sprd,coefficient: coefficient used to calculate voltage
- sprd,irq-threshold-button: button threshold value
- nvmem-cells: cells used to read efuse value
- nvmem-cell-names: names of cells
- sprd,headset-button: headset key
- adc-min: minimum adc value of a headset key
- adc-max: maximum adc value of a headset key
- code: headset key ID

Example:
sprd_headset: sprd-headset {
		compatible = "sprd,headset";
		sprd,jack-type = <0>;
		io-channels = <&pmic_adc 20>;
		io-channel-names = "headmic_in_little";
		gpios = <&pmic_eic 6 GPIO_ACTIVE_HIGH>;
		sprd,debounce-interval = <10>;
		gpio-names = "aud_int_all";
		sprd,adc-threshold-3pole-detect = <3054>;
		sprd,adc-gnd = <336>;
		sprd,stable-value = <2223>;
		sprd,coefficient = <906270>;
		sprd,irq-threshold-button = <5>;
		nvmem-cells = <&headset_adc_fir>, <&headset_adc_sec>;
		nvmem-cell-names = "hp_adc_fir_calib", "hp_adc_sec_calib";

		sprd,headset-button@0 {
			adc-min = <0>;
			adc-max = <399>;
			code = <226>;
		};
	};
```

## Documentation/devicetree/bindings/sound/ucp1301.txt
```
Spreadtrum Communications UCP1301 smart pa bindings

UCP1301 is a high performance, low noise analog audio smart
amplifier with current and voltage sensing ADC inside, which
specialized in music and audio applications with speaker temperature
and membrane excursion protection to avoid speaker damage.

======

Required properties:
- compatible : Should be "sprd,ucp1301-smartpa"
- reg: I2C slave address, 0x58.
- reset-gpios: a GPIO spec for the reset pin.

======

Example:

	ucp1301_smartpa: ucp1301@58 {
		compatible = "sprd,ucp1301-smartpa";
		reg = <0x58>;
		reset-gpios = <&ap_gpio 134 GPIO_ACTIVE_HIGH>;
	};
```

## Documentation/devicetree/bindings/staging/sprd/sprd,dbg-log.txt
```
dbg-log for Spreadtrum platforms

Required properties:
- compatible: should be one of following:
	"sprd,dbg-log-sharkl5",
	"sprd,dbg-log-roc1",
	"sprd,dbg-log-orca".
- reg: Specify the physical base address of the controller and length
  	of memory mapped region.
- sprd,syscon-mm-ahb:
	use to get phy mm ahb address.
- sprd,syscon-dsi-apb:
	use to get phy dsi apb address.
- sprd,ch-name:
	channel name list of serdes function supported by hardware.
- sprd,ch-index:
	channel index list of serdes function supported by hardware.
- sprd,dcfix:
	value of dc_blnc_fix(fix DC balance issue of 8b/10b encoder). set to enable.
- sprd,mm:
	call sprd_cam_pw_on funtion to power mm on. set to enable.


Examples:
	modem_dbg_log: modem-dbg-log@324F0000 {
		compatible = "sprd,dbg-log-sharkl5";
		reg = <0 0x324F0000 0 0x4000>;
		sprd,syscon-mm-ahb = <&mm_ahb_regs>;
		sprd,syscon-dsi-apb = <&anlg_phy_g10_regs>;
		sprd,ch-name = "TRAINING", "WTL", "MDAR", "TPIU", "DBUS", "WCN";
		sprd,ch-index = <15 1 0 2 3 4>;
		sprd,dcfix;
		sprd,mm;
		status = "disabled";
	};
```

## Documentation/devicetree/bindings/thermal/sprd-cpu-cooling.txt
```
sprd cpu cooling driver

This describes the device tree binding for the sprd cpu cooling driver
which include cpu power model data based on sprd platform.

Required properties:
- compatible:
  - "sprd,cluster-cooling" : cooling domain name
- sprd,core-temp-scale: core temperature scaling
- sprd,core-voltage-scale: core voltage scaling
- sprd,cluster-temp-scale: cluster temperature scaling
- sprd,cluster-voltage-scale: cluster voltage scaling
- sprd,hotplug-period: hotplug cpu period
- sprd,min-cpufreq: the minimum frequency
- sprd,min-cpunum: the minimum cpu online number
- sprd,core-base: core leakage
- sprd,cluster-base: cluster leakage
- sprd,dynamic-core: core dynamic
- sprd,dynamic-cluster: cluster dynamic

Optional properties:
- sprd,efuse-block7: block id
- sprd,efuse-block15: block id
- sprd,leak-core: core leakage in block
- sprd,leak-cluster: cluste leakage in block
- sprd,efuse-switch: using efuse switch

Example:
	cooling-devices {
		cluster0_cooling: cluster0-cooling {
			compatible = "sprd,cluster-cooling";
			sprd,efuse-block7 = <7>;
			sprd,efuse-block15 = <15>;
			/* core_leak =                             */
			/*(LIT_LEAK[4:0]+1) x 2mA x 0.85V x 18.69% */
			sprd,leak-core = <2 85 1869>;
			/* cluster_leak =                           */
			/* (LIT_LEAK[4:0]+1) x 2mA x 0.85V x 25.24% */
			sprd,leak-cluster = <2 85 2524>;
			/*core Tscale = aT^3 + bT^2 + cT +di   */
			sprd,core-temp-scale =
			/* a*10^7   b*10^7      c*10^7     d*10^7 */
			<  31      (-3041)      170000    (-1590000)>;
			/*core Vscale = eV^3 + fV^2 + gV + h */
			sprd,core-voltage-scale =
			/* e*10^2   f*10^2     g*10^2  h*10^2*/
			<  3320     (-7489)      5692      (-1423)>;
			/*cluster Tscale = aT^3 + bT^2 + cT +di   */
			sprd,cluster-temp-scale =
			/* a*10^7   b*10^7      c*10^7     d*10^7 */
			<  31      (-3041)      170000    (-1590000)>;
			/*cluster Vscale = eV^3 + fV^2 + gV + h */
			sprd,cluster-voltage-scale =
			/* e*10^2   f*10^2     g*10^2  h*10^2*/
			<  3320     (-7489)      5692      (-1423)>;
			sprd,efuse-switch = <0>;
			sprd,hotplug-period = <10>;
			sprd,min-cpufreq = <768000>;
			sprd,min-cpunum = <3>;
			sprd,core-base = <3930>;
			sprd,cluster-base = <1673>;
			sprd,dynamic-core =
			/*Pdynperghz*10    Freq     Vbase  */
			< 1084           1000     1000>;
			sprd,dynamic-cluster =
			/*Pdynperghz*10    Freq     Vbase  */
			< 757           1000     1000>;
		};
```

## Documentation/devicetree/bindings/thermal/sprd-thermal.txt
```
= Spreadtrum thermal device tree bindings =

Required properties:
- compatible : "sprd,sharkl5-thermal"
- reg : Address range of the thermal registers
- clock-names: "enable" for thermal module enable clock.
- clocks: Should contain a clock specifier for each entry in clock-names.
- reg: sensor number.
- nvmem-cells: A phandle to the calibration data provided by a nvmem device.
- nvmem-cell-names: Should be "calibration"
- sprd,ideal-k: ideal slope, according to thermal datasheet adc value conversion
		temperature formula
		T_final = ideal-k ratio * x - ideal-b + 16 - bin2dec(efuse[i:j]).
- sprd,ideal-b: ideal offset, according to thermal datasheet adc value conversion
		temperature formula
		T_final = ideal-k ratio * x - ideal-b + 16 - bin2dec(efuse[i:j]).

Example:

	ap_thm: thermal@402f0000 {
		compatible = "sprd,sharkl5-thermal";
		reg = <0 0x402f0000 0 0x1000>;
		clock-names = "enable";
		clocks = <&clk_aon_apb_gates1 1>;
		#thermal-sensor-cells = <1>;

		cpu-sensor@0{
			reg = <0>;
			nvmem-cells = <&thermal_calib>;
			nvmem-cell-names = "calibration";
			sprd,ideal-k = <903>;
			sprd,ideal-b = <71290>;
		};

		gpu-sensor@1{
			reg = <1>;
			nvmem-cells = <&thermal_calib>;
			nvmem-cell-names = "calibration";
			sprd,ideal-k = <903>;
			sprd,ideal-b = <71290>;
		};

		.....
		.....
		.....
	};
```

## Documentation/devicetree/bindings/timer/sprd,time-sync.txt
```
Unisoc time-sync bindings

The sprd time sync feature used for APCP / APCH and so on.
It will create a device and send an event to HAL when the
time requires synchronization.

Required Properties:
- compatible: must be "sprd,time-sync".

Example:
	time_sync {
		compatible = "sprd,time-sync";
	};
```

## Documentation/devicetree/bindings/trusty/sprd-trusty.txt
```
* Spreadtrum trusty information

Required properties:
- compatible: must be one of:
  * "sprd,customipi"
  * "sprd,trusty-smc-v1"
  * "sprd,trusty-irq-v1"
  * "sprd,trusty-virtio-v1"
  * "sprd,trusty-log-v1"


- reg: offset and length of the register set for the device
- interrupts: exactly one interrupt specifier

Example:
	trusty {
		compatible = "sprd,trusty-smc-v1";

		irq {
			compatible = "sprd,trusty-irq-v1";
			interrupt-templates = <&ipi 0>,
					      <&gic 1 GIC_PPI 0>,
					      <&gic 1 GIC_SPI 0>;
		};

		virtio {
			compatible = "sprd,trusty-virtio-v1";
		};

		log {

			compatible = "sprd,trusty-log-v1";
		};
	};
```

## Documentation/devicetree/bindings/usb/27xx-typec.txt
```
Spreadtrum 27XX TYPEC device tree bindings
================================================================

Required properties:
 - compatible: should be one of the following
		"sprd,sc2730-typec"
 - reg: physical base address of the musb and length of memory mapped region
 - interrupt-parent: phandle for the Interrupt Controller
 - interrupts: typec interrupt of the Interrupt Controller

Example:
-------
Board specific DT entry:

	pmic_typec: typec@380 {
		compatible = "sprd,sc27xx-typec", "sprd,sc2730-typec";
		interrupt-parent = <&sc2730_pmic>;
		interrupts = <8 IRQ_TYPE_LEVEL_HIGH>;
		reg = <0x380>;
	};
```

## Documentation/devicetree/bindings/usb/hsphy.txt
```
Spreadtrum Generic USB PHY
===========================================================

Required properties:
  - compatible: should be one of following:
    "sprd,sharkl3-phy",
    "sprd,roc1-phy"
  - reg: must be the PHY controller base address
  - reg-names: "phy_glb_regs" for the usb phy global register
  - sprd,syscon-enables: specify the handle for aon apb syscon
  - sprd,syscon-apahb: specify the handle for ap ahb syscon
  - sprd,syscon-anag4: specify the handle for anlg_phy_g4 syscon
  - sprd,vdd-voltage: the voltage should be set 3.3V
  - #phy-cells: should be set respectively to <0>

Example
-------

Board specific DT entry:

	hsphy: hsphy@e00000 {
		compatible = "sprd,sharkl3-phy";
		reg = <0xe00000 0x3030>;
		reg-names = "phy_glb_regs";
		sprd,syscon-enable = <&aon_apb_regs>;
		sprd,syscon-apahb = <&ap_ahb_regs>;
		sprd,syscon-anag4 = <&anlg_phy_g4_regs>;
		sprd,vdd-voltage = <3300000>;
		#phy-cells = <0>;
	};
```

## Documentation/devicetree/bindings/usb/usb.txt
```
Spreadtrum Generic MUSB driver
================================================================

Required properties:
 - compatible: should be one of the followings:
   "sprd,sharkl3-musb",
   "sprd,roc1-musb"
 - reg: physical base address of the musb and length of memory mapped region
 - interrupts: interrupt number for the musb controller
 - interrupt-names: corresponding interrupt names for the interrupts
                    listed in the 'interrupts'
 - clocks: define which clk to core_clk
 - clock-names: Should contain "core_clk"
 - usb-phy: phandle for the PHY device
 - dr-mode: Should be "peripheral"

Example:
-------

Board specific DT entry:

	usb: usb@20200000 {
		compatible  = "sprd,sharkl3-musb";
		reg = <0x20200000 0x2000>;
		interrupts = <GIC_SPI 55 IRQ_TYPE_LEVEL_HIGH>;
		interrupt-names = "mc";
		clocks = <&clk_ap_ahb_gates CLK_OTG_EB>;
		clock-names = "core_clk";
		usb-phy = <&hsphy>;
		phy-names = "usb";
		dr-mode = "peripheral";
	};
```

## drivers/clk/sprd/Kconfig
```kconfig
# SPDX-License-Identifier: GPL-2.0-only
config SPRD_COMMON_CLK
	tristate "Clock support for Spreadtrum SoCs"
	depends on ARCH_SPRD || COMPILE_TEST
	default ARCH_SPRD
	select REGMAP_MMIO

if SPRD_COMMON_CLK

# SoC Drivers

config SPRD_SC9860_CLK
	tristate "Support for the Spreadtrum SC9860 clocks"

config SPRD_SC9863A_CLK
	tristate "Support for the Unisoc SC9863A clocks"
	help
	  Support for the global clock controller on sc9863a devices.
	  Say Y if you want to use peripheral devices on sc9863a SoC.

config SPRD_UMS512_CLK
	tristate "Support for the Unisoc UMS512 clocks"
	help
	  Support for the global clock controller on ums512 devices.
	  Say Y if you want to use peripheral devices on ums512 SoC.

config SPRD_UMS9230_CLK
	tristate "Support for the Unisoc UMS9230 clocks"
	help
	  Support for the global clock controller on ums9230 devices.
	  Say Y if you want to use peripheral devices on ums9230 SoC.

config SPRD_UMS9620_CLK
        tristate "Support for the Unisoc UMS9620 clocks"
        help
          Support for the global clock controller on ums9620 devices.
          Say Y if you want to use peripheral devices on ums9620 SoC.

config SPRD_SC7731E_CLK
	tristate "Support for the Unisoc SC7731E clocks"
	help
	  Support for the global clock controller on sc7731e devices.
	  Say Y if you want to use peripheral devices on sc7731e SoC.

config SPRD_SC9832E_CLK
	tristate "Support for the Unisoc SC9832E clocks"
	help
	  Support for the global clock controller on sc9832e devices.
	  Say Y if you want to use peripheral devices on sc9832e SoC.

config SPRD_UMS312_CLK
	tristate "Support for the Unisoc UMS312 clocks"
	help
	  Support for the global clock controller on ums312 devices.
	  Say Y if you want to use peripheral devices on ums312 SoC.
endif
```

## drivers/gpu/drm/sprd/Kconfig
```kconfig
# SPDX-License-Identifier: GPL-2.0-only
config DRM_SPRD
	tristate "DRM Support for Unisoc SoCs Platform"
	depends on ARCH_SPRD || COMPILE_TEST
	depends on DRM && OF
	select DRM_KMS_HELPER
	select DRM_GEM_CMA_HELPER
	select DRM_KMS_CMA_HELPER
	select VIDEOMODE_HELPERS
	help
	  Choose this option if you have a Unisoc chipsets.
	  If M is selected the module will be called sprd-drm.

#
#SPRD DRM GSP driver
#
source "drivers/gpu/drm/sprd/gsp/Kconfig"

if DRM_SPRD

comment "Unisoc Dummy CRTC&Encoder"

config DRM_SPRD_DUMMY
	bool "Dummy CRTC&Encoder"
	help
	  Choose this option if you want to use dummy crtc&encoder.

comment "Unisoc CRTCs"

config DRM_SPRD_DPU0
	bool "Primary Display Controller"
	help
	  Choose this option if you want to use primary display controller.

config DRM_SPRD_DP
	bool "Display Port"
	help
	  Choose this option if you want to use Display Port.

config DRM_SPRD_DPU1
	bool "External Display Controller"
	help
	  Choose this option if you want to use external display controller.

comment "Unisoc Encoders and Bridges"

config DRM_SPRD_DSI
	bool "DSI Host Controller"
	depends on DRM_SPRD_DPU0
	select DRM_MIPI_DSI
	select DRM_PANEL
	select BACKLIGHT_CLASS_DEVICE
	help
	  Choose this option if you want to use DSI host controller.

config DRM_SPRD_WB_DEBUG
	bool "DPU WriteBack Debug"
	depends on DRM_SPRD_DPU0
	help
	  Choose this option if you want to use DPU WriteBack Debug.

endif
```

## drivers/gpu/drm/sprd/gsp/Kconfig
```kconfig
config DRM_SPRD_GSP
	tristate "SPRD DRM GSP driver"
	depends on ARCH_SPRD
	depends on DRM_SPRD
	help
	  GSP is hardware which not only can compose multiple layers
	  but also can transform and scale layers.

config DRM_SPRD_GSP_IPC_TRUSTY
	bool "SPRD DRM GSP widevine driver"
	depends on DRM_SPRD_GSP
	depends on TRUSTY_VIRTIO_IPC
	---help---
	  This function is to support the widevine function.
```
