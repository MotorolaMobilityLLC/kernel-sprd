## Documentation/devicetree/bindings/ipa/ipa.txt
```
IPA for Spreadtrum platforms

Required properties:
- compatible: Should be "sprd,sipa".
- reg: Specify the physical base address of the controller and length
  of memory mapped region.
- interrupts: Should contain ipa interrupt.
- sprd,sipa-bypass-mode: IPA work mode select. 0: bypass mode 1: normal_mode
- sprd,usb-dl-tx: 
	First parameter indicates usb dl tx common fifo is it in iram. 0: DDR 1: iram.
	Second parameter indicates usb dl tx common fifo total depth.
- sprd,usb-dl-rx: 
	First parameter indicates usb dl rx common fifo is it in iram. 0: DDR 1: iram.
	Second parameter indicates usb dl rx common fifo total depth.
- sprd,usb-ul-tx: 
	First parameter indicates usb ul tx common fifo is it in iram. 0: DDR 1: iram.
	Second parameter indicates usb ul tx common fifo total depth.
- sprd,usb-ul-rx: 
	First parameter indicates usb ul rx common fifo is it in iram. 0: DDR 1: iram.
	Second parameter indicates usb ul rx common fifo total depth.
- sprd,cp-dl-tx: 
	First parameter indicates cp dl tx common fifo is it in iram. 0: DDR 1: iram.
	Second parameter indicates cp dl tx common fifo total depth.
- sprd,cp-dl-rx: 
	First parameter indicates cp dl rx common fifo is it in iram. 0: DDR 1: iram.
	Second parameter indicates cp dl rx common fifo total depth.
- sprd,cp-ul-tx: 
	First parameter indicates cp ul tx common fifo is it in iram. 0: DDR 1: iram.
	Second parameter indicates cp ul tx common fifo total depth.
- sprd,cp-ul-rx: 
	First parameter indicates cp ul rx common fifo is it in iram. 0: DDR 1: iram.
	Second parameter indicates cp ul rx common fifo total depth.
- sprd,wifi-dl-tx: 
	First parameter indicates wifi dl tx common fifo is it in iram. 0: DDR 1: iram.
	Second parameter indicates wifi dl tx common fifo total depth.
- sprd,wifi-dl-rx: 
	First parameter indicates wifi dl rx common fifo is it in iram. 0: DDR 1: iram.
	Second parameter indicates wifi dl rx common fifo total depth.
- sprd,wifi-ul-tx: 
	First parameter indicates wifi ul tx common fifo is it in iram. 0: DDR 1: iram.
	Second parameter indicates wifi ul tx common fifo total depth.
- sprd,wifi-ul-rx: 
	First parameter indicates wifi ul rx common fifo is it in iram. 0: DDR 1: iram.
	Second parameter indicates wifi ul rx common fifo total depth.
- sprd,ap-eth-dl-tx: 
	First parameter indicates ap eth dl tx common fifo is it in iram. 0: DDR 1: iram.
	Second parameter indicates ap eth dl tx common fifo total depth.
- sprd,ap-eth-dl-rx: 
	First parameter indicates ap eth dl rx common fifo is it in iram. 0: DDR 1: iram.
	Second parameter indicates ap eth dl rx common fifo total depth.
- sprd,ap-eth-ul-tx: 
	First parameter indicates ap eth ul tx common fifo is it in iram. 0: DDR 1: iram.
	Second parameter indicates ap eth ul tx common fifo total depth.
- sprd,ap-eth-ul-rx: 
	First parameter indicates ap eth ul rx common fifo is it in iram. 0: DDR 1: iram.
	Second parameter indicates ap eth ul rx common fifo total depth.
- sprd,ap-ip-dl-tx: 
	First parameter indicates ap ip dl tx common fifo is it in iram. 0: DDR 1: iram.
	Second parameter indicates ap ip dl tx common fifo total depth.
- sprd,ap-ip-dl-rx: 
	First parameter indicates ap ip dl rx common fifo is it in iram. 0: DDR 1: iram.
	Second parameter indicates ap ip dl rx common fifo total depth.
- sprd,ap-ip-ul-tx: 
	First parameter indicates ap ip ul tx common fifo is it in iram. 0: DDR 1: iram.
	Second parameter indicates ap ip ul tx common fifo total depth.
- sprd,ap-ip-ul-rx: 
	First parameter indicates ap ip ul rx common fifo is it in iram. 0: DDR 1: iram.
	Second parameter indicates ap ip ul rx common fifo total depth.
- sprd,ap-pcie0-dl-tx: 
	First parameter indicates ap pcie0 dl tx common fifo is it in iram. 0: DDR 1: iram.
	Second parameter indicates ap pcie0 dl tx common fifo total depth.
- sprd,ap-pcie0-dl-rx: 
	First parameter indicates ap pcie0 dl rx common fifo is it in iram. 0: DDR 1: iram.
	Second parameter indicates ap pcie0 dl rx common fifo total depth.
- sprd,ap-pcie0-ul-tx: 
	First parameter indicates ap pcie0 ul tx common fifo is it in iram. 0: DDR 1: iram.
	Second parameter indicates ap pcie0 ul tx common fifo total depth.
- sprd,ap-pcie0-ul-rx: 
	First parameter indicates ap pcie0 ul rx common fifo is it in iram. 0: DDR 1: iram.
	Second parameter indicates ap pcie0 ul rx common fifo total depth.
- sprd,ap-pcie1-dl-tx: 
	First parameter indicates ap pcie1 dl tx common fifo is it in iram. 0: DDR 1: iram.
	Second parameter indicates ap pcie1 dl tx common fifo total depth.
- sprd,ap-pcie1-dl-rx: 
	First parameter indicates ap pcie1 dl rx common fifo is it in iram. 0: DDR 1: iram.
	Second parameter indicates ap pcie1 dl rx common fifo total depth.
- sprd,ap-pcie1-ul-tx: 
	First parameter indicates ap pcie1 ul tx common fifo is it in iram. 0: DDR 1: iram.
	Second parameter indicates ap pcie1 ul tx common fifo total depth.
- sprd,ap-pcie1-ul-rx: 
	First parameter indicates ap pcie1 ul rx common fifo is it in iram. 0: DDR 1: iram.
	Second parameter indicates ap pcie1 ul rx common fifo total depth.
- sprd,ap-pcie2-dl-tx: 
	First parameter indicates ap pcie2 dl tx common fifo is it in iram. 0: DDR 1: iram.
	Second parameter indicates ap pcie2 dl tx common fifo total depth.
- sprd,ap-pcie2-dl-rx: 
	First parameter indicates ap pcie2 dl rx common fifo is it in iram. 0: DDR 1: iram.
	Second parameter indicates ap pcie2 dl rx common fifo total depth.
- sprd,ap-pcie2-ul-tx: 
	First parameter indicates ap pcie2 ul tx common fifo is it in iram. 0: DDR 1: iram.
	Second parameter indicates ap pcie2 ul tx common fifo total depth.
- sprd,ap-pcie2-ul-rx: 
	First parameter indicates ap pcie2 ul rx common fifo is it in iram. 0: DDR 1: iram.
	Second parameter indicates ap pcie2 ul rx common fifo total depth.
- sprd,ap-pcie3-dl-tx: 
	First parameter indicates ap pcie3 dl tx common fifo is it in iram. 0: DDR 1: iram.
	Second parameter indicates ap pcie3 dl tx common fifo total depth.
- sprd,ap-pcie3-dl-rx: 
	First parameter indicates ap pcie3 dl rx common fifo is it in iram. 0: DDR 1: iram.
	Second parameter indicates ap pcie3 dl rx common fifo total depth.
- sprd,ap-pcie3-ul-tx: 
	First parameter indicates ap pcie3 ul tx common fifo is it in iram. 0: DDR 1: iram.
	Second parameter indicates ap pcie3 ul tx common fifo total depth.
- sprd,ap-pcie3-ul-rx: 
	First parameter indicates ap pcie3 ul rx common fifo is it in iram. 0: DDR 1: iram.
	Second parameter indicates ap pcie3 ul rx common fifo total depth.

Examples:
	pa_local: sprd,sipa@21180000 {
		compatible = "sprd,sipa";
		reg = <0 0x21180000 0 0x00001000>,
			<0 0x21040000 0 0x00000140>,
			<0 0x20b10000 0 0x00040000>;
		reg-names = "glb-base", "ipa-sys", "iram-base";
		interrupts = <GIC_SPI 138 IRQ_TYPE_LEVEL_HIGH>;
		interrupt-names = "local_ipa_irq";

		sprd,sipa-bypass-mode = <0>;

		sprd,usb-dl-tx = <1 1024>;
		sprd,usb-dl-rx = <1 1024>;
		sprd,usb-ul-tx = <1 1024>;
		sprd,usb-ul-rx = <1 1024>;
		sprd,cp-dl-tx = <1 1024>;
		sprd,cp-dl-rx = <1 1024>;
		sprd,cp-ul-tx = <1 1024>;
		sprd,cp-ul-rx = <1 1024>;
		sprd,wifi-dl-tx = <1 1024>;
		sprd,wifi-dl-rx = <1 1024>;
		sprd,wifi-ul-tx = <1 1024>;
		sprd,wifi-ul-rx = <1 1024>;
		sprd,ap-eth-dl-tx = <0 1024>;
		sprd,ap-eth-dl-rx = <0 1024>;
		sprd,ap-eth-ul-tx = <0 1024>;
		sprd,ap-eth-ul-rx = <0 1024>;
		sprd,ap-ip-dl-tx = <0 1024>;
		sprd,ap-ip-dl-rx = <0 1024>;
		sprd,ap-ip-ul-tx = <0 1024>;
		sprd,ap-ip-ul-rx = <0 1024>;
		sprd,ap-pcie0-dl-tx = <0 256>;
		sprd,ap-pcie0-dl-rx = <0 256>;
		sprd,ap-pcie0-ul-tx = <0 256>;
		sprd,ap-pcie0-ul-rx = <0 256>;
		sprd,ap-pcie1-dl-tx = <0 256>;
		sprd,ap-pcie1-dl-rx = <0 256>;
		sprd,ap-pcie1-ul-tx = <0 256>;
		sprd,ap-pcie1-ul-rx = <0 256>;
		sprd,ap-pcie2-dl-tx = <0 0>;
		sprd,ap-pcie2-dl-rx = <0 0>;
		sprd,ap-pcie2-ul-tx = <0 0>;
		sprd,ap-pcie2-ul-rx = <0 0>;
		sprd,ap-pcie3-dl-tx = <0 0>;
		sprd,ap-pcie3-dl-rx = <0 0>;
		sprd,ap-pcie3-ul-tx = <0 0>;
		sprd,ap-pcie3-ul-rx = <0 0>;

	};
```

## Documentation/devicetree/bindings/mfd/sprd,ump96xx-pmic.txt
```
UNISOC UMP96xx Power Management Integrated Circuit (PMIC)

The UNISOC UMP96xx series PMICs contain UMP9620, UMP9621 and UMP9622.
The Spreadtrum PMIC belonging to SC27xx series integrates all mobile
handset power management, audio codec, battery management and user
interface support function in a single chip. It has 6 major functional
blocks:
- DCDCs to support CPU, memory.
- LDOs to support both internal and external requirement.
- Battery management system, such as charger, fuel gauge.
- Audio codec.
- User interface function, such as indicator, flash LED and so on.
- IC level interface, such as power on/off control, RTC and typec and so on.

Required properties:
- compatible: Should be one of the following:
	"sprd,ump9620"
	"sprd,ump9621"
	"sprd,ump9622"

- reg: The address of the device chip select.
- spi-max-frequency: Typically set to 26000000.
- interrupts: The interrupt line the device is connected to.
- interrupt-controller: Marks the device node as an interrupt controller.
- #interrupt-cells: The number of cells to describe an PMIC IRQ, must be 2.
- #address-cells: Child device offset number of cells, must be 1.
- #size-cells: Child device size number of cells, must be 0.

Example:
pmic@0 {
	compatible = "sprd,ump9620";
	reg = <0>;
	spi-max-frequency = <26000000>;
	interrupts = <GIC_SPI 31 IRQ_TYPE_LEVEL_HIGH>;
	interrupt-controller;
	#interrupt-cells = <2>;
	#address-cells = <1>;
	#size-cells = <0>;
};
```

## Documentation/devicetree/bindings/misc/cam.txt
```
Unisoc Camera devices

This node provides properties for controlling the Unisoc Camera device.

Required properties:

 - compatible should be one of following:
	"unisoc,sharkl3-cam"
	"unisoc,sharkl5pro-cam"

Example:
dcam: dcam@60a00000 {
	compatible = "unisoc,sharkl3-cam";
}
```

## Documentation/devicetree/bindings/misc/sprdwcn/sprd,marlin3.txt
```
Spreadtrum SC2355 platform devices.

This node provides properties for controlling the SPREADTRUM wireless device.

Required properties:

- compatible : Should be "sprd,marlin3".
- m2-to-ap-coexist-gpios : sc2355 GPIO0, used for debug.
- m2-wakeup-ap-gpios : sc2355 GPIO1, CP2 wake up AP for SDIO.
- permit-ap-send-gpios : SC2355 GPIO2. permit ap send data to wcn chip.
- wait-ge2 : used for GNSS download through SDIO, not use UART.
- common-chip : BTWF and GNSS share the same chip_eb pin.
- power-off : wcn chip default power on when the phone on.
- adma-tx : supprt SDIO ADMA function in tx side.
- adma-rx : supprt SDIO ADMA function in rx side.
- pwrseq : SDIO's power sequencing.
- post-power-on-delay-ms : delay value when power on/off.

Optional properties:
- vddio-supply = <&vddgen>: this supply is alway on.
- power-off :SC2355 chip not power down.

Example:

	sprd_marlin3: sprd-marlin3 {
		compatible = "sprd,marlin3";
		m2-to-ap-coexist-gpios = <&ap_gpio 119 GPIO_ACTIVE_LOW>;
		m2-wakeup-ap-gpios = <&ap_gpio 77 GPIO_ACTIVE_LOW>;
		permit-ap-send-gpios = <&ap_gpio 69 GPIO_ACTIVE_LOW>;
		reset-gpios = <&ap_gpio 95 GPIO_ACTIVE_LOW>;
		enable-gpios = <&ap_gpio 94 GPIO_ACTIVE_LOW>;
		dvdd12-supply = <&vddcon>;
		avdd12-supply = <&vddcon>;
		avdd33-supply = <&vddwifipa>;
		clock-names = "clk_32k","source","enable";
		clocks = <&clk_aux0>,<&ext_32k>,
			 <&clk_aon_apb_gates1 2>;
		sdhci-name = <&sdio1>;
		common-chip;
		power-off;
		wait-ge2;
		adma-tx;
		adma-rx;
		pwrseq;
		post-power-on-delay-ms = <20>;
	};

	gnss_common_ctl {
		compatible = "sprd,gnss_common_ctl";
	};
```
