## Documentation/devicetree/bindings/cpufreq/cpufreq-hwdvfs-sprd.txt
```
DT binding for Unisoc apcpu hardware dvfs driver in platforms whose dvfs ip is similar to sharkl5
=================================================================================================

Both apcpu_dvfs and topdvfs_controller nodes listed below must be defined.

Node apcpu_dvfs
-------------------------
Required properties:
- compatible: must iclude: sprd,cpufreq-v2.

Node topdvfs_controller
------------------------
Required properties:
- compatible: must select one config from following options
	sprd,sharkl5-topdvfs and syscon,
	sprd,roc1-topdvfs and syscon,
	sprd,sharkl5pro-topdvfs and syscon,
	sprd,orca-topdvfs and syscon.
- sprd,syscon-enable: A phandle to the aon apb controller node
- module-enable-cfg: A property describing how to enable or disable the
			topdvfs_controller configuration. for example, <0x4 7>
			means the register offset in aon apb controller is 0x4,
			the control bit is 7.
- reg: physical base address and the length of the register set for
	the top dvfs device.
- device-dcdc-cells: A phandle to the power domains supplying for devices
			excluding DSU and cores, every power domain which supports
			hardware dvfs function has its own dvfs controller in
			top dvfs device.
	- dcdc_XX: child node of topdvfs_controller node, XX represents the
		  device name such as mm, modem
		- dcdc-dvfs-enable: A property describing how to control the
			dvfs function of power domain dcdc_XX. for example,
			<0x18 20 0> means that the register offset is 0x18, the
			function control bit is 20, and the hw dvfs function
			should be disabled.
		- dcdc-judge-vol-sw: A property describing some necessary
			information of the judge voltage which must be matched
			with the real voltage value before enable the hardware
			dvfs function. for exapmple, <0x18 1 0x7 7> means the
			register offset is 0x18, the left shift base bit is 1,
			the mask is 0x7, the current real voltage for this
			dcdc_XX power domain is 7(1.0v).
		- dcdc-subsys-cells: A phandle to the subsystem supplied by
		 	 dcdc_XX.
			- YY_sys: child node of dcdc_XX, YY represents the name
			  of a subsystem.
				-dcdc-subsys-tune-enable: A property describing
					how to control the hw dvfs function of
					the YY_sys.for example, <0x150 5 0>
					means the register offset is 0x150, the
					control bit is 5, and the hw dvfs
					function should be disabled.
Optional properties:
- dcdc-modem-mm-share-en: The register information to enable dcdc-modem and
			dcdc-mm shared, for example, <0x170 0> means the
			register offest in top dvfs is 0x170, the control bit is 0.
- dcdc-modem-mm-share: A bool flag, if this flag is defined in board dts, it
			means the power domains dcdc-modem and dcdc-mm are
			shared in hardware design.

Example 1: Example for apcpu_dvfs
---------
apcpu_dvfs: apcpu-dvfs {
	compatible = "sprd,cpufreq-v2";
};

Example 2: Example for topdvfs_controller
---------
topdvfs_controller: topdvfsctrl@322A0000 {
	compatible = "sprd,sharkl5-topdvfs", "syscon";
	sprd,syscon-enable = <&aon_apb_regs>;
	module-enable-cfg = <0x4 7>;
	reg = <0 0x322A0000 0 0x8000>;
	device-dcdc-cells = <&dcdc_mm>;

	<...>

	dcdc_mm: dcdc-mm {
		dcdc-dvfs-enable = <0x18 20 0>;
		dcdc-judge-vol-sw = <0x18 1 0x7 7>;
		dcdc-subsys-cells =	<&audcp_sys>,
					<&gpu_sys>,
					<&mm_sys>;
		audcp_sys: audcp-sys {
			dcdc-subsys-tune-enable = <0x150 5 0>;
		};

		<...>
	};

	<...>
};

&topdvfs_controller {
	dcdc-modem-mm-share-en = <0x170 0>;
	dcdc-modem-mm-share;
};
```

## Documentation/devicetree/bindings/devfreq/sprd/sprd,ddr-dvfs.txt
```
Spreadtrum ddr dvfs bindings

This dirver give functions for ddr frequency control to userspace.

Required properties:
- compatible:
  -"sprd,sharkl5pro-ddr-dvfs" for ums512
  -"sprd,sharkl3-ddr-dvfs" for sp9863a

- freq-num: Specifies the max frequency points supported by soc.

Example:
ddr_dfs: scene-frequency {
	compatible = "sprd,sharkl5pro-ddr-dvfs";
	freq-num = <8>;
};
```

## Documentation/devicetree/bindings/iio/sprd_hub/sprd-sensorhub.txt
```
Unisoc sensor hub bindings

Unisoc's some SoCs integrates sensor hub. This sensor hub driver collect and
analyze data uploaded from sensors.

Required Properties:
- compatible: consisted of platform name and common name.
  - "sprd,sharkl3-sensorhub", "sprd,sensor-hub": for Sharkl3-compatible sensor hub,
  - "sprd,sharkl5-sensorhub", "sprd,sensor-hub": for Sharkl5-compatible sensor hub,
  - "sprd,sharkl5Pro-sensorhub", "sprd,sensor-hub": for Sharkl5pro-compatible sensor hub,
  - "sprd,roc1-sensorhub", "sprd,sensor-hub": for Roc1-compatible sensor hub
  - "sprd,qogirl6-sensorhub", "sprd,sensor-hub": for qogirl6-compatible sensor hub


Example:
	sprd-sensorhub {
		compatible = "sprd,sharkl5-sensorhub", "sprd,sensor-hub";
	};
```

## Documentation/devicetree/bindings/input/sprd,sc27xx-vibra.txt
```
Spreadtrum SC27xx PMIC Vibrator

Required properties:
- compatible: following options:
		"sprd,sc2731-vibrator",
		"sprd,sc2730-vibrator",
		"sprd,sc2721-vibrator".
- reg: address of vibrator control register.

Example :

	sc2731_pmic: pmic@0 {
		compatible = "sprd,sc2731";
		reg = <0>;
		spi-max-frequency = <26000000>;
		interrupts = <GIC_SPI 31 IRQ_TYPE_LEVEL_HIGH>;
		interrupt-controller;
		#interrupt-cells = <2>;
		#address-cells = <1>;
		#size-cells = <0>;

		vibrator@eb4 {
			compatible = "sprd,sc2731-vibrator";
			reg = <0xeb4>;
		};
	};
```

## Documentation/devicetree/bindings/input/sprd-keypad.txt
```
* sprd's Keypad Controller device tree bindings

sprd's Keypad controller is used to interface a SoC with a matrix-type
keypad device. The keypad controller supports multiple row and column lines.
A key can be placed at each intersection of a unique row and a unique column.
The keypad controller can sense a key-press and key-release and report the
event using a interrupt to the cpu.

Required SoC Specific Properties:
- compatible: should be one of the following
  - "sprd,v0-keypad": For controllers compatible with keypad version 0
    controller.
  - "sprd,v1-keypad": For controllers compatible with keypad version 1
    controller.

- reg: physical base address of the controller and length of memory mapped
  region.

- interrupts: The interrupt number to the cpu.

- sprd,glb-rst-off: Offset of AON APB RESET register which contains
  keypad soft reset bit

- sprd,glb-eb-off: Offset of AON APB EB register which contains keypad
  enable bit

- sprd,glb-rtc-eb-off: Offset of AON APB EB register which contains
  keypad rtc enable bit

- sprd,bit-kpd-soft-rst: Bit of keypad soft reset

- sprd,bit-kpd-eb: Bit of keypad enable

- sprd,bit-kpd-rtc-eb: Bit of keypad rtc enable


Required Board Specific Properties:
- sprd,num-rows: Number of row lines connected to the keypad
  controller.

- sprd,num-columns: Number of column lines connected to the
  keypad controller.

- Keys represented as child nodes: Each key connected to the keypad
  controller is represented as a child node to the keypad controller
  device node and should include the following properties.
  - keypad,row: the row number to which the key is connected.
  - keypad,column: the column number to which the key is connected.
  - linux,code: the key-code to be reported when the key is pressed
    and released.

- pinctrl-0: Should specify pin control groups used for this controller.
- pinctrl-names: Should contain only one value - "default".

Optional Properties:
- wakeup-source: use any event on keypad as wakeup event.
(Legacy property supported: "linux,input-wakeup")

Optional Properties specific to linux:
- linux,repeat: enable autorepeat feature.


Example:
	keypad@40250000 {
		compatible = "sprd,v1-keypad";
		reg = 	<0x40250000 0x1000>;
		sprd,syscon-enable = <&aon_apb_regs>;
		sprd,glb-rst-off = <REG_AON_APB_APB_RST0>;
		sprd,glb-eb-off = <REG_AON_APB_APB_EB0>;
		sprd,glb-rtc-eb-off = <REG_AON_APB_APB_RTC_EB0>;
		sprd,bit-kpd-soft-rst = <MASK_AON_APB_KPD_SOFT_RST>;
		sprd,bit-kpd-eb = <MASK_AON_APB_KPD_EB>;
		sprd,bit-kpd-rtc-eb = <MASK_AON_APB_KPD_RTC_EB>;
		interrupts = <0 36 0x0>;
		sprd,keypad-num-rows = <3>;
		sprd,keypad-num-columns = <3>;
		sprd,keypad-rows-choose-hw = <0x70000>;
		sprd,keypad-cols-choose-hw = <0x700>;
		sprd,debounce_time = <5>;
		status = "ok";

		key_1 {
			keypad,row = <0>;
			keypad,column = <0>;
			linux,code = <1>;
		};
		key_2 {
			keypad,row = <1>;
			keypad,column = <0>;
			linux,code = <2>;
		};
		key_3 {
			keypad,row = <0>;
			keypad,column = <2>;
			linux,code = <3>;
		};
	};
```
