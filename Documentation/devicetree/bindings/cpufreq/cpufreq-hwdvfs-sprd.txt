## Documentation/devicetree/bindings/pci/sprd-pcie.txt
```
Spreadtrum PCIe controller DT description

Spreadtrum PCIe host controller is based on Designware PCI core.
It shares common functions with PCIe Designware core driver and inherits
common properties defined in
Documentation/devicetree/bindings/pci/designware-pci.txt.

Additional properties are described here:

Required properties:
 - compatible: Should be "sprd,pcie" for RC
	       Should be "sprd,pcie-ep" for EP
 - num-lanes as specified in ../designware-pcie.txt

HOST MODE
=========
 - reg: Should contain dbi, config registers location and length.
 - reg-names: Must include the following entries:
	      "dbi": controller configuration registers;
	      "config": PCIe configuration space registers.
 - #address-cells,
 - #size-cells,
 - #interrupt-cells,
 - device_type,
 - ranges,
 - interrupt-map-mask,
 - interrupt-map: as specified in ../designware-pcie.txt

 - sprd,pcie-startup-syscons:
	The global registers of pcie are used when pcie startup.
	Each group syscon has 6 cells as follows:
	- phandle of pcie syscon for used for pcie host controller
	- the type of syscon:
          0： set/clear, use regmap_update_bits() to operate these registers
          1: not set/clear, use regmap_read() and regmap_write() to operate
             these registers
	- the delay value: the delay time (unit: us) after the syscon is set
	- register: the register to be operated by the syscon
	- mask: the mask of the syscon register
	- value: the value to be set to the syscon register mask
 - sprd,pcie-shutdown-syscons:
	The global registers of pcie are used when pcie shutdown.
	This property is the same as sprd,pcie-startup-syscons.
 - sprd,pcie-resume-syscons:
	The global registers of pcie are used when pcie resume.
	This property is the same as sprd,pcie-startup-syscons.
 - sprd,pcie-suspend-syscons:
	The global registers of pcie are used when pcie suspend.
	This property is the same as sprd,pcie-startup-syscons.
 - sprd,pcie-perst-assert:
	The global registers of pcie are used when pcie assert PERST#.
	This property is the same as sprd,pcie-startup-syscons.
 - sprd,pcie-perst-deassert:
	The global registers of pcie are used when pcie deassert PERST#.
	This property is the same as sprd,pcie-startup-syscons.
 - sprd,pcie-aspml1p2-syscons:
	The global registers of pcie are used when pcie enter ASPM L1.2.
	This property is the same as sprd,pcie-startup-syscons.

- interrupts: as specified about #interrupt-cells.
- interrupt-names: must include "msi" entries.

DEVICE MODE
===========
 - reg : Three register ranges as listed in the reg-names property
 - reg-names: "dbi" for simple register. Single register accessed directly by
	      its address. Most of registers (including configuration space,
	      iATU and DMA) are of this type.
	      "dbi2" for shadow register. Another register exists at the same
	      address as a Simple register. For example the BAR Mask registers
	      have the same address as the BAR registers.
 - num-ib-windows: number of inbound address translation windows
 - num-ob-windows: number of outbound address translation windows

Example:
pcie0@2b100000 {
	compatible = "sprd,pcie", "snps,dw-pcie";
	reg = <0x0 0x2b100000 0x0 0x2000>,
	      <0x2 0x00000000 0x0 0x2000>;
	reg-names = "dbi", "config";
	#address-cells = <3>;
	#size-cells = <2>;
	device_type = "pci";
	ranges = <0x01000000 0x0 0x00000000 0x2 0x00002000 0x0 0x00010000
		  0x03000000 0x0 0x10000000 0x2 0x10000000 0x1 0xefffffff>;
	bus-range = <0  15>;
	num-lanes = <1>;
	num-vectors = <256>;
	num-viewport = <8>;
	interrupts = <GIC_SPI 153 IRQ_TYPE_LEVEL_HIGH>;
	interrupt-names = "msi";
	sprd,pcie-startup-syscons =
		<&aon_apb_regs 0 0
			REG_AON_APB_RF_PCIE_SLV_ADDR_OFFSET
			MASK_AON_APB_RF_PCIE_SLV_ADDR_OFFSET
			0x1>,
		<&aon_apb_regs 0 0
			REG_AON_APB_RF_PCIE_SLV_ADDR_OFFSET
			MASK_AON_APB_RF_PCIE_MOD_SEL
			0x10000>,
		<&aon_apb_regs 0 0
			REG_AON_APB_RF_PHY_REF_CLK_EN
			MASK_AON_APB_RF_PCIE_PHY_REF_CLK_EN
			0x200>,
		<&pmu_apb_regs 0 0
			REG_PMU_APB_RF_PCIEPLL_H_REL_CFG
			MASK_PMU_APB_RF_PCIEPLL_H_FRC_OFF
			0x0>,
		<&ap_ipa_ahb_regs 0 0
			REG_AP_IPA_AHB_RF_AHB_EB
			MASK_AP_IPA_AHB_RF_PCIE_SEL
			0x0>,
		<&ap_ipa_ahb_regs 0 0
			REG_AP_IPA_AHB_RF_AHB_EB
			MASK_AP_IPA_AHB_RF_PCIE_AUX_EB
			0x40>,
		<&ap_ipa_ahb_regs 0 0
			REG_AP_IPA_AHB_RF_AHB_EB
			MASK_AP_IPA_AHB_RF_PCIE_EB
			0x20>,
		<&pmu_apb_regs 0 0
			REG_PMU_APB_RF_PCIE_SLP_CFG
			MASK_PMU_APB_RF_PCIE_CLKREQ_PLL_GATE_MASK
			0x0>;

	sprd,pcie-shutdown-syscons =
		<&ap_ipa_ahb_regs 0 0
			REG_AP_IPA_AHB_RF_AHB_EB
			MASK_AP_IPA_AHB_RF_PCIE_EB
			0x0>;

	sprd,pcie-resume-syscons =
		<&ap_ipa_ahb_regs 0 0
			REG_AP_IPA_AHB_RF_AHB_EB
			MASK_AP_IPA_AHB_RF_PCIE_EB
			0x20>;

	sprd,pcie-suspend-syscons =
		<&ap_ipa_ahb_regs 0 0
			REG_AP_IPA_AHB_RF_AHB_EB
			MASK_AP_IPA_AHB_RF_PCIE_EB
			0x0>;

	sprd,pcie-aspml1p2-syscons =
		<&anlg_pcie20_phy_regs 1 0
			REG_PIPE_CFGA_ANA_CFG13
			MASK_PIPE_CFGA_ANA_CFG13_CFG_FORCE_REFCLK_EN
			(0x1 << 23)>;

	sprd,pcie-perst-deassert =
		<&pmu_apb_regs 0 200
			REG_PMU_APB_RF_PCIE_SLP_CFG
			MASK_PMU_APB_RF_REG_PERST_N_ASSERT
			0x0>;

	sprd,pcie-perst-assert =
		<&pmu_apb_regs 0 200
			REG_PMU_APB_RF_PCIE_SLP_CFG
			MASK_PMU_APB_RF_REG_PERST_N_ASSERT
			0x10>;
};

pcie1@2b100000 {
	compatible = "sprd,pcie-ep", "snps,dw-pcie";
	reg = <0x0 0x2b100000 0x0 0x2000>,
	      <0x0 0x2b108000 0x0 0x2000>,
	      <0x2 0x00000000 0x2 0x00000000>;
	reg-names = "dbi", "dbi2","addr_space";
	interrupts = <GIC_SPI 55 IRQ_TYPE_LEVEL_HIGH>;
	num-lanes = <1>;
	num-ib-windows = <6>;
	num-ob-windows = <8>;
};
```

## Documentation/devicetree/bindings/power/supply/fan54015_charger.txt
```
FAIRCHILD FAN54015 PMIC battery charger binding

Required properties:
 - compatible: Should be one of the following:
 "fairchild, fan54015_chg",
 "prisemi,psc5415z_chg".
 - reg: Address offset of charger register.
 - phys: Contains a phandle to the USB phy.
 - extcon: used to detect if vbus is high level.

Optional Properties:
 - monitored-battery: phandle of battery characteristics devicetree node.
  The charger uses the following battery properties:
 - charge-term-current-microamp: current for charge termination phase.
 - constant-charge-voltage-max-microvolt: maximum constant input voltage.
 - charge-sdp-current-microamp: An array providing the current and
   limit current for SDP charger type.
 - charge-dcp-current-microamp: An array providing the current and
   limit current for DCP charger type.
 - charge-cdp-current-microamp: An array providing the current and
   limit current for CDP charger type.
 - charge-unknown-current-microamp: An array providing the current and
   limit current for unknown charger type.
 See Documentation/devicetree/bindings/power/supply/battery.txt

Example:

	bat: battery {
		compatible = "simple-battery";
		charge-term-current-microamp = <120000>;
		constant-charge-voltage-max-microvolt = <4350000>;
		charge-sdp-current-microamp = <500000 500000>;
		charge-dcp-current-microamp = <1500000 3000000>;
		charge-cdp-current-microamp = <1500000 1500000>;
		charge-unknown-current-microamp = <500000 500000>;
		......
	};

	&i2c4 {
		status = "okay";
		clock-frequency = <400000>;

		fan54015_chg: charger@6a {
			compatible = "fairchild,fan54015_chg";
			reg = <0x6a>;
			phys = <&hsphy>;
			monitored-battery = <&bat>;
			extcon = <&extcon_gpio>;
		};
	};
```

## Documentation/devicetree/bindings/power/supply/sc2703_charger.txt
```
Spreadtrum SC2703 battery charger binding

Required properties:
 - compatible: Should be "sprd,sc2703-charger".
 - reg: Address offset of charger register.
 - phys: Contains a phandle to the USB phy.

Optional Properties:
- monitored-battery: phandle of battery characteristics devicetree node.
  The charger uses the following battery properties:
- charge-term-current-microamp: current for charge termination phase.
- constant-charge-voltage-max-microvolt: maximum constant input voltage.
  See Documentation/devicetree/bindings/power/supply/battery.txt

Example:

	bat: battery {
		compatible = "simple-battery";
		charge-term-current-microamp = <120000>;
		constant-charge-voltage-max-microvolt = <4350000>;
		......
	};

	sc2703-charger {
		compatible = "sprd,sc2703-charger";
		reg = <0x4c>;
		phys = <&ssphy>;
		monitored-battery = <&bat>;
	};
```

## Documentation/devicetree/bindings/regulator/sprd,cpudvfs-regulator.txt
```
Binding for cpudvfs device regulator
Create a virtual i2c device to adjust the cpu's voltage via an i2c channel

Required properties:
	- compatible: define the compatible property for the i2c device to
	 	      match the specific i2c driver.
	- reg: i2c address

Example:
	cpudvfs@61{
		compatible = "sprd,cpudvfs-regulator-sharkl5";
		reg = <0x61>;
	};
```

## Documentation/devicetree/bindings/regulator/sprd,sc2720-regulator.txt
```
Spreadtrum SC2720 Voltage regulators

The SC2720 integrates low-voltage and low quiescent current DCDC/LDO.

Required properties:
 - compatible: should be "sprd,sc2720-regulator" or "sprd,sc27xx-regulator".

List of regulators provided by this controller. It is named according to
its regulator type, DCDC_<name> and LDO_<name>. The definition for each
of these nodes is defined using the standard binding for regulators at
Documentation/devicetree/bindings/regulator/regulator.txt.

Example:
	regulators {
		compatible = "sprd,sc2720-regulator";

		vddarm0: DCDC_CPU0 {
			regulator-name = "vddarm0";
			regulator-min-microvolt = <400000>;
			regulator-max-microvolt = <1996875>;
			regulator-ramp-delay = <25000>;
			regulator-always-on;
		};

		vddcama0: LDO_CAMA0 {
			regulator-name = "vddcama0";
			regulator-min-microvolt = <1200000>;
			regulator-max-microvolt = <3750000>;
			regulator-enable-ramp-delay = <100>;
		};
		...
	};
```

## Documentation/devicetree/bindings/regulator/sprd,sc2721-regulator.txt
```
Spreadtrum SC2721 Voltage regulators

The SC2721 integrates low-voltage and low quiescent current DCDC/LDO.
18 LDO and 4 DCDCs are designed for external use.

Required properties:
 - compatible: should be "sprd,sc2721-regulator" or "sprd,sc2731-regulator".

List of regulators provided by this controller. It is named according to
its regulator type, DCDC_<name> and LDO_<name>. The definition for each
of these nodes is defined using the standard binding for regulators at
Documentation/devicetree/bindings/regulator/regulator.txt.

Example:
	regulators {
		compatible = "sprd,sc2721-regulator";

		vddarm0: DCDC_CPU0 {
			regulator-name = "vddarm0";
			regulator-min-microvolt = <400000>;
			regulator-max-microvolt = <1996875>;
			regulator-ramp-delay = <25000>;
			regulator-always-on;
		};

		vddcama0: LDO_CAMA0 {
			regulator-name = "vddcama0";
			regulator-min-microvolt = <1200000>;
			regulator-max-microvolt = <3750000>;
			regulator-enable-ramp-delay = <100>;
		};
		...
	};
```

## Documentation/devicetree/bindings/sipa/sipa-sys.txt
```
sipa system for Spreadtrum platforms

Required properties:
- compatible: Should be "sprd,roc1-sipa-sys".
- syscons: Should contain the base address, offset and bit for each entry in "syscon-names".
- syscon-names: global register bits name, order and name should the same as code.
	ipa-sys-pciepllhsel: clear bit will unbind between PCIEPLL_H and IPA_SYS.
	ipa-sys-pciepllvsel: clear bit will unbind between PCIEPLL_V and IPA_SYS.
	ipa-sys-xtlbufpciehsel: clear bit will unbind between XTLBUF_PCIEH and IPA_SYS.
	ipa-sys-xtlbufpcievsel: clear bit will unbind between XTLBUF_PCIEV and IPA_SYS.

Examples:
	ipa_sys: sipa-sys {
		compatible = "sprd,roc1-sipa-sys";
		syscons    = <&pmu_apb_regs
				REG_PMU_APB_IPA_FORCE_WAKEUP_CFG
				MASK_PMU_APB_IPA_FORCE_WAKEUP>,
				<&pmu_apb_regs
				REG_PMU_APB_PD_IPA_SYS_CFG
				MASK_PMU_APB_PD_IPA_SYS_FORCE_SHUTDOWN>,
				<&pmu_apb_regs
				REG_PMU_APB_PCIEPLL_H_REL_CFG
				MASK_PMU_APB_PCIEPLL_H_IPA_SEL>,
				<&pmu_apb_regs
				REG_PMU_APB_PCIEPLL_V_REL_CFG
				MASK_PMU_APB_PCIEPLL_V_IPA_SEL>,
				<&pmu_apb_regs
				REG_PMU_APB_XTLBUF_PCIEH_REL_CFG
				MASK_PMU_APB_XTLBUF_PCIEH_IPA_SEL>,
				<&pmu_apb_regs
				REG_PMU_APB_XTLBUF_PCIEV_REL_CFG
				MASK_PMU_APB_XTLBUF_PCIEV_IPA_SEL>;
		syscon-names = "ipa-sys-forcewakeup",
				"ipa-sys-forceshutdown"
				"ipa-sys-pciepllhsel",
				"ipa-sys-pciepllvsel",
				"ipa-sys-xtlbufpciehsel",
				"ipa-sys-xtlbufpcievsel";
	};
```

## Documentation/devicetree/bindings/soc/sprd/sprd,7sreset.txt
```
Spreadtrum 7sreset bindings

This IP block in the unisoc SoC that only deals with hardware reboot-force.

Required properties:
- compatible:
  -"sprd,sc2720-7sreset" for SC2720 7sreset
  -"sprd,sc2721-7sreset" for SC2721 7sreset
  -"sprd,sc2730-7sreset" for SC2730 7sreset
  -"sprd,sc2731-7sreset" for SC2731 7sreset
  -"sprd,ump9622-7sreset" for UMP9622 7sreset

- reg: Specifies the physical address of the SWRST_CTL0 and POR_7S_CTL register.
- regsw: Specifies the physical address of the refout control register.
- refnum: The number of pmic refout.

Example:
hw-reset@1bc0 {
	compatible = "sprd,sc2730-7sreset";
	reg = <0x1bf8>, <0x1bc0>;
};
refout@2000 {
	compatible = "sprd,ump9622-refout";
	regsw = <0x2080>;
	refnum = <4>;
};
```

## Documentation/devicetree/bindings/soc/sprd/sprd,debuglog.txt
```
Unisoc debuglog bindings

This node is used to define control information and address space node used the
power debug driver, which output the power and interrupt state will help us to
analyze the SoC system power exception.

Required properties:
- compatible:
	"sprd,debuglog-sharkl6pro",
	"sprd,debuglog-sharkl6",
	"sprd,debuglog-sharkl5pro",
	"sprd,debuglog-sharkl5",
	"sprd,debuglog-sharkl3",
	"sprd,debuglog-sharkle",
	"sprd,debuglog-pike2

- sprd,scan-enable:
	1-enable the state log output;
	0-disable the log output;
- sprd,scan-interval:
	Specify the log output period of the default log thread

- sprd,sys-ap-ahb:
	Specify the ap-ahb address space node in the soc system
- sprd,sys-ap-apb:
	Specify the ap-apb address space node in the soc system

- sprd,sys-pmu-apb:
	Specify the pmu-apb address space node in the soc system

Optional properties:
- sprd,sys-aon-apb:
	Specify the aon-apb address space node in the soc system

- sprd,sys-ap-intc:
	Specify the ap-intc address space node in th soc system,
	if not define CONFIG_SPRD_SIP_FW, this node is must require

Example:
	debug_log: debuglog {
		compatible = "sprd,debuglog-sharkl5pro";

		sprd,scan-enable = <1>;
		sprd,scan-interval = <30>;

		sprd,sys-ap-ahb = <&ap_ahb_regs>;
		sprd,sys-ap-apb = <&ap_apb_regs>;
		sprd,sys-pmu-apb = <&pmu_apb_regs>;
		sprd,sys-aon-apb = <&aon_apb_regs>;

		sprd,sys-ap-intc0 = <&ap_intc0_regs>;
		sprd,sys-ap-intc1 = <&ap_intc1_regs>;
		sprd,sys-ap-intc2 = <&ap_intc2_regs>;
		sprd,sys-ap-intc3 = <&ap_intc3_regs>;
		sprd,sys-ap-intc4 = <&ap_intc4_regs>;
		sprd,sys-ap-intc5 = <&ap_intc5_regs>;
	};
```

## Documentation/devicetree/bindings/soc/sprd/sprd,modem_ctrl.txt
```
Spreadtrum mcd bindings

Required properties:
- compatible: must be "sprd,roc1-modem-ctrl".
- poweron-gpio: control modem power.
- reset-gpio: control modem reset.
- cpwatchdog-gpio: modem watchdog reset int.
- cpassert-gpio: modem assert int.
- cppanic-gpio: modem panic int.
Example:

	sprd-mcd {
		compatible = "sprd,roc1-modem-ctrl";
		poweron-gpio = <&ap_gpio 15 GPIO_ACTIVE_LOW>;
		reset-gpio = <&ap_gpio 16 GPIO_ACTIVE_LOW>;
		cpwatchdog-gpio = <&ap_gpio 29 GPIO_ACTIVE_LOW>;
		cpassert-gpio = <&ap_gpio 30 GPIO_ACTIVE_LOW>;
		cppanic-gpio = <&ap_gpio 31 GPIO_ACTIVE_LOW>;
	};
```
