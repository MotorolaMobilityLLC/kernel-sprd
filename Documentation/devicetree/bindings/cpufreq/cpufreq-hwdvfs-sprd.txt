## Documentation/devicetree/bindings/soc/sprd/sprd,pmic_syscon.txt
```
SOC PMIC Syscon Driver

The driver is developed for UNISOC platform's PMIC, which is used by PMIC's
multi modules for finding PMIC's address easier.

Required properties:
-compatible:
 -"sprd,sc2721-syscon" for SC2721 syscon
 -"sprd,sc2730-syscon" for SC2730 syscon
 -"sprd,sc2731-syscon" for SC2731 syscon
- reg: Specifies the PMIC's physical global address.

Example:
syscon@1800 {
	compatible = "sprd,sc2731-syscon", "sprd,sc27xx-syscon";
	reg = <0x1800>, <0x1ba0>, <0x1b98>;
};
```

## Documentation/devicetree/bindings/soc/sprd/sprd,powerdebug.txt
```
Unisoc power-debug bindings

This node is used to define control information and address space node used the
power debug driver, which output the power and interrupt state will help us to
analyze the SoC system power exception.

Required properties:
- compatible: Should be "sprd,debuglog"

optional properties:
 - sprd,pdbg-irq-domain-gic: irq domain name for gic
 - sprd,pdbg-irq-domain-gpio: irq domain name for gpio
 - sprd,pdbg-irq-domain-ana: irq domain name for ana
 - sprd,pdbg-irq-domain-ana-eic: irq domain name for ana eic
 - sprd,pdbg-irq-domain-ap-eic-dbnc: irq domain name for ap dbnc eic
 - sprd,pdbg-irq-domain-ap-eic-latch: irq domain name for ap latch eic
 - sprd,pdbg-irq-domain-ap-eic-async: irq domain name for ap async eic
 - sprd,pdbg-irq-domain-ap-eic-sync: irq domain name for ap sync eic

Example:
	debug_log: debuglog {
		compatible                         = "sprd,debuglog";
		sprd,pdbg-irq-domain-gic           = "GICv3";
		sprd,pdbg-irq-domain-gpio          = "sprd-gpio-plus";
		sprd,pdbg-irq-domain-ana           = "spi4.0";
		sprd,pdbg-irq-domain-ana-eic       = "41800000.spi:pmic@0:gpio-controller@280";
		sprd,pdbg-irq-domain-ap-eic-async  = "402100a0.gpio";
	};
```

## Documentation/devicetree/bindings/soc/sprd/sprd,powerstat.txt
```
soc debugstat bindings

The node uses to count individual subsystems information, which output log will
help us to analyze the SoC system power exception.

Required properties:
- compatible: must be "sprd,debugstat".

Example 1: Example for sharkl5pro debugstate
----------
debug_stat: debugstat {
	compatible = "sprd,debugstat";
};
```

## Documentation/devicetree/bindings/soc/sprd/sprd,sc27xx-refout.txt
```
UNISCO sc27xx refout bindings

This node is used to control pmic refout by other code.

Required properties:
- compatible:
  -"sprd,sc27xx-refout" for sc27xx refout

- regsw: Specifies the physical address of the refout control register.

- refnum: The number of pmic refout.

Example:
refout@1800 {
    compatible = "sprd,sc27xx-refout";
    regsw = <0x1AEC>;
    refnum = <5>;
};
```

## Documentation/devicetree/bindings/soc/sprd/sprd,sfp.yaml
```yaml
# SPDX-License-Identifier: (GPL-2.0 OR BSD-2-Clause)

$id: "http://devicetree.org/schemas/soc/sprd/sprd,sfp.yaml#"
$schema: "http://devicetree.org/meta-schemas/core.yaml#"

title: Unisoc sfp bindings

description: SFP stands for soft fast path, it is a module to configure IPA route rule or do a soft IP acceleration.

Required properties:
  compatible:
    - "sprd,sfp": soft fast path
    - "sprd,tether_scheme": for setting acceleration way, 0 stands for hard-way, 1 stands for soft-way, 2 stands for half-hard-half-soft
    - "sprd,enable": for switch of the SFP, 0 stands for disable, 1 stands for enable
```

## Documentation/devicetree/bindings/soc/sprd/sprd,sipa_eth.txt
```
Unisoc sipa-eth bindings

This is only for virtual network interface controller that dealing with ipa data transferring.

Required properties:
- compatible: Must be "sprd,sipa_eth".
- sprd,netid: index for SIPA NIC interface
- sprd,term-type: names for the various IPA srouce / destination ID

Example:

aliases {
	eth0 = &sipa_eth0;
	...
	eth8 = &sipa_eth8;
};

sipa_eth8:  sipa-wifi {
	compatible = "sprd,sipa_eth";
	sprd,netid = <0>;
	sprd,term-type = <0x2>;
};

sipa_eth0: sipa-eth0 {
	compatible = "sprd,sipa_eth";
	sprd,netid = <1>;
	sprd,term-type = <0x6>;
};
```
